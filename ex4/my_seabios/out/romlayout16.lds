
/* DO NOT EDIT!  This is an autogenerated file.  See scripts/layoutrom.py. */
OUTPUT_FORMAT("elf32-i386")
OUTPUT_ARCH("i386")
SECTIONS
{
_cfunc32flat_tpm_interrupt_handler32 = 0xf1ab2 ;
e820_list = 0x5ea0 ;
sercon_char = 0xf16d ;
_cfunc32flat_handle_smi = 0xf1e56 ;
_cfunc16_check_irqs = 0x877d ;
rx_buf = 0xf15c ;
_cfunc32flat_call32_params_helper = 0xf0458 ;
DebugOutputPort = 0x6194 ;
sercon_enable = 0xf171 ;
IntelDisplayType = 0x61b2 ;
reply_msg = 0xf13c ;
HaveSmmCall32 = 0x62d4 ;
e820_count = 0x5e84 ;
TimerKHz = 0x619c ;
LegacyRamSize = 0x5e80 ;
ViaRamSpeed = 0x61b4 ;
CDRom_locks = 0xf178 ;
acpi_pm1a_cnt = 0x5e64 ;
sercon_attr = 0xf16c ;
FloppyInfo = 0x6120 ;
sercon_row_last = 0xf16e ;
SMPLock = 0xf5380 ;
_cfunc32flat_handle_resume32 = 0xf15e7 ;
emulated_drive_gf = 0xf188 ;
_cfunc32flat_xhci_poll_intr = 0xf1dec ;
_cfunc32flat_process_op_32 = 0xf0468 ;
_cfunc16_invoke_mouse_handler = 0xb9ca ;
mouse_pipe = 0x618c ;
bounce_buf_fl = 0x61ec ;
StackPos = 0xf1b0 ;
sercon_split = 0xf172 ;
DefaultDPTE = 0xf1a0 ;
sercon_col_last = 0xf16f ;
CanPreempt = 0x62c4 ;
sercon_real_vga_handler = 0x61e4 ;
VGAHookHandlerType = 0x61bc ;
_cfunc32flat_handle_post = 0xf1984 ;
_cfunc32seg_handle_pcibios = 0x6767 ;
MaxPCIBus = 0x5e6c ;
sercon_attr_last = 0xf170 ;
FloppyCount = 0x62c0 ;
ShiftTSC = 0x6196 ;
_cfunc32flat_handle_pmm = 0xe9e1e ;
_cfunc16_wait_irq = 0xb75d ;
IDMap = 0x6200 ;
Call16Data = 0xf9bc ;
MainThread = 0x62c8 ;
pmode_IDT_info = 0x6318 ;
PirAddr = 0x5e68 ;
_cfunc32flat_handle_smp = 0xf20c2 ;
_cfunc32flat_handle_19 = 0xf1a85 ;
SmiBootDisplay = 0x61b0 ;
CDEmu = 0xf18c ;
ViaFBsize = 0x61b8 ;
LastUSBkey = 0xf144 ;
keyboard_pipe = 0x6190 ;
_cfunc32seg_handle_apm = 0x6a5d ;
rombios32_gdt_48 = 0x62d8 ;
HaveRunPost = 0x6328 ;
SMPStack = 0xf537c ;
_cfunc32flat_yield_preempt = 0xe55e2 ;
rx_bytes = 0xf159 ;
Century = 0xf158 ;
ExtraStack = 0xf1b8 ;
diskette_param_table2 = 0x617c ;
rmode_IDT_info = 0x6320 ;
_cfunc32flat_handle_18 = 0xf1a59 ;
TimerPort = 0x6198 ;
_cfunc16__farcall16 = 0x8044 ;
Ps2ctr = 0xf14c ;
FloppyDOR = 0xf140 ;
BIOS_CONFIG_TABLE = 0xe6f5 ;
RTCusers = 0xf150 ;
cdemu_drive_gf = 0x61e8 ;
IntelDisplayId = 0x61b1 ;
TimerLast = 0xf154 ;
sercon_port = 0xf174 ;

    zonelow_base = 0xdc800 ;
    _zonelow_seg = 0xdc80 ;

.text.set_a20 0x6c00 : { *(.text.set_a20) }
.text.set_code_success 0x6c20 : { *(.text.set_code_success) }
.text.pic_eoi2 0xe826 : { *(.text.pic_eoi2) }
.text.call32_prep 0x6c2c : { *(.text.call32_prep) }
.text.memset 0x6cc5 : { *(.text.memset) }
.text.enqueue_key 0x6cd4 : { *(.text.enqueue_key) }
.text.kbd_set_flag 0x6d2c : { *(.text.kbd_set_flag) }
.text.handle_1524XX 0x6d8b : { *(.text.handle_1524XX) }
.text.cursor_pos_row 0x6d97 : { *(.text.cursor_pos_row) }
.text.sercon_cursor_pos_set 0xe6ff : { *(.text.sercon_cursor_pos_set) }
.text.shiftbuf 0xfeae : { *(.text.shiftbuf) }
.text.irqtimer_check 0x6da8 : { *(.text.irqtimer_check) }
.text.qemu_debug_putc 0x6de1 : { *(.text.qemu_debug_putc) }
.text.ehci_reset_pipe 0x6ded : { *(.text.ehci_reset_pipe) }
.text.lba2chs 0x6e32 : { *(.text.lba2chs) }
.text.scsi_fill_cmd 0x6e76 : { *(.text.scsi_fill_cmd) }
.text.on_extra_stack 0x6eed : { *(.text.on_extra_stack) }
.text.__stack_hop_back 0x6f11 : { *(.text.__stack_hop_back) }
.text.default_process_op.isra.8 0x6f73 : { *(.text.default_process_op.isra.8) }
.text.__disk_ret.isra.9 0x6f94 : { *(.text.__disk_ret.isra.9) }
.text.__disk_ret_unimplemented.isra.10 0x6fc3 : { *(.text.__disk_ret_unimplemented.isra.10) }
.text.getLCHS 0x6feb : { *(.text.getLCHS) }
.text.disk_1308 0x7092 : { *(.text.disk_1308) }
.text.disk_1315 0x71cc : { *(.text.disk_1315) }
.text.getComAddr 0x722e : { *(.text.getComAddr) }
.text.getLptAddr 0x7260 : { *(.text.getLptAddr) }
.text.pci_config_readl 0x7293 : { *(.text.pci_config_readl) }
.text.putsinglehex.isra.50 0x72be : { *(.text.putsinglehex.isra.50) }
.text.puthex.isra.51 0x72d5 : { *(.text.puthex.isra.51) }
.text.puts_cs.isra.54 0x737b : { *(.text.puts_cs.isra.54) }
.text.clear_usertimer 0x7396 : { *(.text.clear_usertimer) }
.text.call32_post 0x73d7 : { *(.text.call32_post) }
.text.floppy_dor_mask 0x747a : { *(.text.floppy_dor_mask) }
.text.floppy_disable_controller 0x749d : { *(.text.floppy_disable_controller) }
.text.rtc_setup 0xfe7e : { *(.text.rtc_setup) }
.text.set_usertimer 0x74a9 : { *(.text.set_usertimer) }
.text.pci_next 0x752c : { *(.text.pci_next) }
.text.putuint.isra.53 0xe6a8 : { *(.text.putuint.isra.53) }
.text.sercon_lazy_lf 0x75bf : { *(.text.sercon_lazy_lf) }
.text.timer_read 0xff5d : { *(.text.timer_read) }
.text.timer_calc 0x760f : { *(.text.timer_calc) }
.text.timer_calc_usec 0x762b : { *(.text.timer_calc_usec) }
.text.timer_check 0x765d : { *(.text.timer_check) }
.text.udelay 0x7679 : { *(.text.udelay) }
.text.ndelay.constprop.87 0x769a : { *(.text.ndelay.constprop.87) }
.text.bvprintf.constprop.100 0xe411 : { *(.text.bvprintf.constprop.100) }
.text.unlikely.panic.constprop.96 0xe2ad : { *(.text.unlikely.panic.constprop.96) }
.text.__dprintf 0x76dc : { *(.text.__dprintf) }
.text.dump_regs 0x76f0 : { *(.text.dump_regs) }
.text.__warn_timeout 0x7787 : { *(.text.__warn_timeout) }
.text.i8042_wait_write 0xf066 : { *(.text.i8042_wait_write) }
.text.__i8042_command 0x779d : { *(.text.__i8042_command) }
.text.fill_generic_edd 0x77f5 : { *(.text.fill_generic_edd) }
.text.fill_edd 0xe079 : { *(.text.fill_edd) }
.text.handle_12 0x7b64 : { *(.text.handle_12) }
.text.handle_11 0x7b77 : { *(.text.handle_11) }
.text.handle_05 0xfa47 : { *(.text.handle_05) }
.text.handle_02 0x7b8a : { *(.text.handle_02) }
.text.call16_helper 0x7b9f : { *(.text.call16_helper) }
.text.__call32 0x7bdf : { *(.text.__call32) }
.text.__call32_params.constprop.98 0x7ca3 : { *(.text.__call32_params.constprop.98) }
.text.usb_poll_intr 0x7ceb : { *(.text.usb_poll_intr) }
.text._farcall16 0x8044 : { *(.text._farcall16) }
.text.__call16_int 0x808f : { *(.text.__call16_int) }
.text.handle_75 0x80a2 : { *(.text.handle_75) }
.text.disk_1346.isra.62 0x8101 : { *(.text.disk_1346.isra.62) }
.text.process_key 0x819b : { *(.text.process_key) }
.text.prockeys 0x858d : { *(.text.prockeys) }
.text.procmodkey 0xff00 : { *(.text.procmodkey) }
.text.ramdisk_copy 0x8604 : { *(.text.ramdisk_copy) }
.text.check_irqs 0x877d : { *(.text.check_irqs) }
.text.sercon_putchar 0x879f : { *(.text.sercon_putchar) }
.text.sercon_term_clear_screen 0x880a : { *(.text.sercon_term_clear_screen) }
.text.sercon_print_utf8 0xef60 : { *(.text.sercon_print_utf8) }
.text.sercon_term_cursor_goto 0x8837 : { *(.text.sercon_term_cursor_goto) }
.text.sercon_set_attr 0x88e2 : { *(.text.sercon_set_attr) }
.text.sercon_lazy_flush 0x89d7 : { *(.text.sercon_lazy_flush) }
.text.sercon_lazy_putchar 0x8afe : { *(.text.sercon_lazy_putchar) }
.text.timer_sleep 0xf046 : { *(.text.timer_sleep) }
.text.usleep 0xec4e : { *(.text.usleep) }
.text.lsi_scsi_process_op 0x8bb4 : { *(.text.lsi_scsi_process_op) }
.text.esp_scsi_process_op 0x8de3 : { *(.text.esp_scsi_process_op) }
.text.mpt_scsi_process_op 0xf869 : { *(.text.mpt_scsi_process_op) }
.text.rtc_updating 0x8fb5 : { *(.text.rtc_updating) }
.text.ps2_recvbyte 0x9002 : { *(.text.ps2_recvbyte) }
.text.ps2_sendbyte 0x90b6 : { *(.text.ps2_sendbyte) }
.text.__ps2_command 0xec62 : { *(.text.__ps2_command) }
.text.set_leds 0xefdb : { *(.text.set_leds) }
.text.mouse_command 0x9131 : { *(.text.mouse_command) }
.text.mouse_15c201 0x9206 : { *(.text.mouse_15c201) }
.text.handle_160a 0x9251 : { *(.text.handle_160a) }
.text.uhci_waittick 0x92af : { *(.text.uhci_waittick) }
.text.uhci_send_pipe.constprop.91 0x930b : { *(.text.uhci_send_pipe.constprop.91) }
.text.ehci_send_pipe.constprop.92 0x96c8 : { *(.text.ehci_send_pipe.constprop.92) }
.text.usb_send_pipe.constprop.90 0x99c4 : { *(.text.usb_send_pipe.constprop.90) }
.text.usb_process_op 0x99fd : { *(.text.usb_process_op) }
.text.uas_process_op 0x9b8e : { *(.text.uas_process_op) }
.text.floppy_wait_irq 0xeeda : { *(.text.floppy_wait_irq) }
.text.floppy_pio 0x9da7 : { *(.text.floppy_pio) }
.text.floppy_enable_controller 0x9ef0 : { *(.text.floppy_enable_controller) }
.text.floppy_drive_pio 0x9f53 : { *(.text.floppy_drive_pio) }
.text.floppy_dma_cmd 0xa005 : { *(.text.floppy_dma_cmd) }
.text.floppy_drive_readid.constprop.86 0xa13b : { *(.text.floppy_drive_readid.constprop.86) }
.text.floppy_prep 0xe990 : { *(.text.floppy_prep) }
.text.floppy_read 0xa181 : { *(.text.floppy_read) }
.text.floppy_write 0xa23a : { *(.text.floppy_write) }
.text.floppy_format 0xa2f3 : { *(.text.floppy_format) }
.text.megasas_process_op 0xa380 : { *(.text.megasas_process_op) }
.text.await_ide.constprop.89 0xf7d2 : { *(.text.await_ide.constprop.89) }
.text.await_not_bsy 0xa5e7 : { *(.text.await_not_bsy) }
.text.send_cmd 0xe2e8 : { *(.text.send_cmd) }
.text.ata_pio_transfer 0xa5f7 : { *(.text.ata_pio_transfer) }
.text.ata_wait_data 0xa72a : { *(.text.ata_wait_data) }
.text.ata_readwrite 0xa763 : { *(.text.ata_readwrite) }
.text.ata_atapi_process_op 0xa8e3 : { *(.text.ata_atapi_process_op) }
.text.process_op 0xaa76 : { *(.text.process_op) }
.text.cdemu_read 0xae14 : { *(.text.cdemu_read) }
.text.disk_1300 0xb03d : { *(.text.disk_1300) }
.text.basic_access 0xb079 : { *(.text.basic_access) }
.text.disk_1305 0xb1a1 : { *(.text.disk_1305) }
.text.disk_1310 0xb29e : { *(.text.disk_1310) }
.text.extended_access 0xb2dd : { *(.text.extended_access) }
.text.disk_13 0xb3ae : { *(.text.disk_13) }
.text.handle_legacy_disk 0xb6d9 : { *(.text.handle_legacy_disk) }
.text.wait_irq 0xb75d : { *(.text.wait_irq) }
.text.dequeue_key 0xe742 : { *(.text.dequeue_key) }
.text.handle_1553 0xb77d : { *(.text.handle_1553) }
.text.handle_40 0xb8e0 : { *(.text.handle_40) }
.text.handle_13 0xb912 : { *(.text.handle_13) }
.text.handle_76 0xb9b9 : { *(.text.handle_76) }
.text.invoke_mouse_handler 0xb9ca : { *(.text.invoke_mouse_handler) }
.text.process_mouse 0xba3d : { *(.text.process_mouse) }
.text.handle_16 0xba94 : { *(.text.handle_16) }
.text.handle_1589 0xbb8b : { *(.text.handle_1589) }
.text.handle_15 0xbc25 : { *(.text.handle_15) }
.text.handle_14 0xc37e : { *(.text.handle_14) }
.text.handle_17 0xe837 : { *(.text.handle_17) }
.text.handle_sercon 0xc553 : { *(.text.handle_sercon) }
.text.handle_1a 0xf562 : { *(.text.handle_1a) }
.text.handle_08 0xf0fc : { *(.text.handle_08) }
.text.handle_70 0xc95d : { *(.text.handle_70) }
.text.handle_resume 0xca4f : { *(.text.handle_resume) }
.text.handle_pnp 0xcb1a : { *(.text.handle_pnp) }
.text.handle_pcibios 0xcb63 : { *(.text.handle_pcibios) }
.text.handle_apm 0xf856 : { *(.text.handle_apm) }
.text.handle_hwpic1 0xce86 : { *(.text.handle_hwpic1) }
.text.handle_hwpic2 0xf84a : { *(.text.handle_hwpic2) }
.text.handle_74 0xce8c : { *(.text.handle_74) }
.text.handle_09 0xcec7 : { *(.text.handle_09) }
.text.handle_0e 0xcf10 : { *(.text.handle_0e) }
.text.asm.transition32 0xcf2a : { *(.text.asm.transition32) }
.text.asm.transition16 0xcf78 : { *(.text.asm.transition16) }
.text.asm.__farcall16 0xcfc6 : { *(.text.asm.__farcall16) }
.text.asm.irq_trampoline_0x02 0xd053 : { *(.text.asm.irq_trampoline_0x02) }
.text.asm.irq_trampoline_0x05 0xd056 : { *(.text.asm.irq_trampoline_0x05) }
.text.asm.irq_trampoline_0x10 0xd059 : { *(.text.asm.irq_trampoline_0x10) }
.text.asm.irq_trampoline_0x13 0xd05c : { *(.text.asm.irq_trampoline_0x13) }
.text.asm.irq_trampoline_0x15 0xd05f : { *(.text.asm.irq_trampoline_0x15) }
.text.asm.irq_trampoline_0x16 0xd062 : { *(.text.asm.irq_trampoline_0x16) }
.text.asm.irq_trampoline_0x18 0xd065 : { *(.text.asm.irq_trampoline_0x18) }
.text.asm.irq_trampoline_0x19 0xd068 : { *(.text.asm.irq_trampoline_0x19) }
.text.asm.irq_trampoline_0x1b 0xd06b : { *(.text.asm.irq_trampoline_0x1b) }
.text.asm.irq_trampoline_0x1c 0xd06e : { *(.text.asm.irq_trampoline_0x1c) }
.text.asm.irq_trampoline_0x4a 0xf041 : { *(.text.asm.irq_trampoline_0x4a) }
.text.asm.entry_smi 0xd071 : { *(.text.asm.entry_smi) }
.text.asm.entry_smp 0xd086 : { *(.text.asm.entry_smp) }
.text.asm.entry_resume 0xd0b6 : { *(.text.asm.entry_resume) }
.text.asm.entry_pmm 0xd0cb : { *(.text.asm.entry_pmm) }
.text.asm.entry_pnp_real 0xd129 : { *(.text.asm.entry_pnp_real) }
.text.asm.entry_apm16 0xd171 : { *(.text.asm.entry_apm16) }
.text.asm.entry_apm32 0xd1b2 : { *(.text.asm.entry_apm32) }
.text.asm.entry_pcibios32 0xd1e4 : { *(.text.asm.entry_pcibios32) }
.text.asm.entry_pcibios16 0xd212 : { *(.text.asm.entry_pcibios16) }
.text.asm.entry_1589 0xd24c : { *(.text.asm.entry_1589) }
.text.asm.entry_bios32 0xd286 : { *(.text.asm.entry_bios32) }
.text.asm.entry_sercon 0xd2a5 : { *(.text.asm.entry_sercon) }
.text.asm.irqentry_extrastack 0xd2ec : { *(.text.asm.irqentry_extrastack) }
.text.asm.irqentry_arg_extrastack 0xd379 : { *(.text.asm.irqentry_arg_extrastack) }
.text.asm.entry_13 0xd41b : { *(.text.asm.entry_13) }
.text.asm.entry_76 0xd424 : { *(.text.asm.entry_76) }
.text.asm.entry_70 0xd42d : { *(.text.asm.entry_70) }
.text.asm.entry_74 0xd436 : { *(.text.asm.entry_74) }
.text.asm.entry_75 0xd43f : { *(.text.asm.entry_75) }
.text.asm.entry_hwpic1 0xd448 : { *(.text.asm.entry_hwpic1) }
.text.asm.entry_hwpic2 0xd451 : { *(.text.asm.entry_hwpic2) }
.text.asm.entry_19 0xd45a : { *(.text.asm.entry_19) }
.text.asm.entry_18 0xd46d : { *(.text.asm.entry_18) }
.rodata 0xd480 : { *(.rodata) }
.rodata.__func__.12577 0xd8c4 : { *(.rodata.__func__.12577) }
.rodata.__func__.11793 0xd8d8 : { *(.rodata.__func__.11793) }
.rodata.__func__.11751 0xd8e4 : { *(.rodata.__func__.11751) }
.rodata.__func__.11425 0xd8f0 : { *(.rodata.__func__.11425) }
.rodata.__func__.11405 0xd8fc : { *(.rodata.__func__.11405) }
.rodata.__func__.10358 0xd90c : { *(.rodata.__func__.10358) }
.rodata.__func__.10436 0xd91c : { *(.rodata.__func__.10436) }
.rodata.__func__.8845 0xd92c : { *(.rodata.__func__.8845) }
.rodata.__func__.8938 0xd938 : { *(.rodata.__func__.8938) }
.rodata.__func__.8718 0xd940 : { *(.rodata.__func__.8718) }
.rodata.__func__.7831 0xd950 : { *(.rodata.__func__.7831) }
.rodata.__func__.7779 0xd960 : { *(.rodata.__func__.7779) }
.rodata.__func__.4547 0xd974 : { *(.rodata.__func__.4547) }
.rodata.__func__.4902 0xd980 : { *(.rodata.__func__.4902) }
.rodata.__func__.1841 0xd98c : { *(.rodata.__func__.1841) }
.rodata.__func__.1828 0xd998 : { *(.rodata.__func__.1828) }
.rodata.__func__.1824 0xd9a4 : { *(.rodata.__func__.1824) }
.data16../src/hw/usb-hid.c.184 0xd9b0 : { *(.data16../src/hw/usb-hid.c.184) }
.data16../src/hw/usb-hid.c.167 0xd9c0 : { *(.data16../src/hw/usb-hid.c.167) }
.data16../src/cp437.c.11 0xdaa0 : { *(.data16../src/cp437.c.11) }
.data16../src/sercon.c.554 0xdca0 : { *(.data16../src/sercon.c.554) }
.data16../src/sercon.c.70 0xdd50 : { *(.data16../src/sercon.c.70) }
.data16../src/kbd.c.374 0xdd58 : { *(.data16../src/kbd.c.374) }
.data16../src/kbd.c.371 0xdd60 : { *(.data16../src/kbd.c.371) }
.data16../src/kbd.c.279 0xdd80 : { *(.data16../src/kbd.c.279) }
.data16../src/mouse.c.106 0xe048 : { *(.data16../src/mouse.c.106) }
.fixedaddr.0xe05b 0xe05b : { *(.fixedaddr.0xe05b) }
.fixedaddr.0xe2c3 0xe2c3 : { *(.fixedaddr.0xe2c3) }
.fixedaddr.0xe3fe 0xe3fe : { *(.fixedaddr.0xe3fe) }
.fixedaddr.0xe6f2 0xe6f2 : { *(.fixedaddr.0xe6f2) }
.fixedaddr.0xe739 0xe739 : { *(.fixedaddr.0xe739) }
.fixedaddr.0xe82e 0xe82e : { *(.fixedaddr.0xe82e) }
.fixedaddr.0xe987 0xe987 : { *(.fixedaddr.0xe987) }
.fixedaddr.0xec59 0xec59 : { *(.fixedaddr.0xec59) }
.fixedaddr.0xef57 0xef57 : { *(.fixedaddr.0xef57) }
.fixedaddr.0xefd2 0xefd2 : { *(.fixedaddr.0xefd2) }
.fixedaddr.0xf045 0xf045 : { *(.fixedaddr.0xf045) }
.fixedaddr.0xf065 0xf065 : { *(.fixedaddr.0xf065) }
.fixedaddr.0xf841 0xf841 : { *(.fixedaddr.0xf841) }
.fixedaddr.0xf84d 0xf84d : { *(.fixedaddr.0xf84d) }
.fixedaddr.0xf859 0xf859 : { *(.fixedaddr.0xf859) }
.fixedaddr.0xfe6e 0xfe6e : { *(.fixedaddr.0xfe6e) }
.fixedaddr.0xfea5 0xfea5 : { *(.fixedaddr.0xfea5) }
.fixedaddr.0xff53 0xff53 : { *(.fixedaddr.0xff53) }
.fixedaddr.0xff54 0xff54 : { *(.fixedaddr.0xff54) }
.fixedaddr.0xfff0 0xfff0 : { *(.fixedaddr.0xfff0) }



        /* Discard regular data sections to force a link error if
         * code attempts to access data not marked with VAR16 (or other
         * appropriate macro)
         */
        /DISCARD/ : {
                *(.text*) *(.data*) *(.bss*) *(.rodata*)
                *(COMMON) *(.discard*) *(.eh_frame) *(.note*)
                }
}
