
/* DO NOT EDIT!  This is an autogenerated file.  See scripts/layoutrom.py. */
OUTPUT_FORMAT("elf32-i386")
OUTPUT_ARCH("i386")
SECTIONS
{
sercon_char = 0xeb96d ;
rx_buf = 0xeb95c ;
sercon_enable = 0xeb971 ;
reply_msg = 0xeb93c ;
CDRom_locks = 0xeb978 ;
sercon_row_last = 0xeb96e ;
emulated_drive_gf = 0xeb988 ;
StackPos = 0xeb9b0 ;
sercon_split = 0xeb972 ;
DefaultDPTE = 0xeb9a0 ;
sercon_col_last = 0xeb96f ;
sercon_attr_last = 0xeb970 ;
tpm_state = 0xeb924 ;
Call16Data = 0xec1bc ;
TPM_interface_shutdown = 0xeb920 ;
BootSequence = 0xeb938 ;
CDEmu = 0xeb98c ;
LastUSBkey = 0xeb944 ;
rx_bytes = 0xeb959 ;
Century = 0xeb958 ;
ExtraStack = 0xeb9b8 ;
sercon_attr = 0xeb96c ;
Ps2ctr = 0xeb94c ;
FloppyDOR = 0xeb940 ;
TPM_working = 0xeb921 ;
RTCusers = 0xeb950 ;
TimerLast = 0xeb954 ;
sercon_port = 0xeb974 ;
entry_15_official = 0xff859 ;
transition16big = 0xfcf8d ;
entry_13_official = 0xfe3fe ;
irq_trampoline_0x16 = 0xfd062 ;
irq_trampoline_0x13 = 0xfd05c ;
entry_1a_official = 0xffe6e ;
irq_trampoline_0x10 = 0xfd059 ;
entry_pnp_prot = 0xfd129 ;
irq_trampoline_0x19 = 0xfd068 ;
_cfunc16_check_irqs = 0xf877d ;
entry_iret_official = 0xfff53 ;
entry_09 = 0xfe987 ;
entry_08 = 0xffea5 ;
entry_pnp_real = 0xfd12d ;
entry_19_official = 0xfe6f2 ;
entry_40 = 0xfec59 ;
entry_02 = 0xfe2c3 ;
_cfunc16_call16_helper = 0xf7b9f ;
entry_05 = 0xfff54 ;
entry_74 = 0xfd436 ;
irq_trampoline_0x18 = 0xfd065 ;
_cfunc16_wait_irq = 0xfb75d ;
entry_smp = 0xfd086 ;
reset_vector = 0xffff0 ;
transition16 = 0xfcf78 ;
entry_smi = 0xfd071 ;
entry_70 = 0xfd42d ;
entry_76 = 0xfd424 ;
entry_pmm = 0xfd0cb ;
entry_75 = 0xfd43f ;
entry_18 = 0xfd46d ;
entry_bios32 = 0xfd286 ;
_cfunc16__farcall16 = 0xf8044 ;
entry_11 = 0xff84d ;
entry_12 = 0xff841 ;
entry_14 = 0xfe739 ;
entry_16 = 0xfe82e ;
entry_17 = 0xfefd2 ;
entry_10 = 0xff065 ;
transition32_nmi_off = 0xfcf42 ;
entry_hwpic1 = 0xfd448 ;
entry_sercon = 0xfd2a5 ;
entry_hwpic2 = 0xfd451 ;
entry_0e = 0xfef57 ;

    _reloc_min_align = 0x20 ;
    zonefseg_start = 0xf5660 ;
    zonefseg_end = 0xf5e60 ;
    zonelow_base = 0xdc800 ;
    final_varlow_start = 0xeb920 ;
    final_readonly_start = 0xec1e0 ;
    varlow_start = 0xd7260 ;
    varlow_end = 0xd7b20 ;
    code32init_start = 0xd7b20 ;
    code32init_end = 0xec1e0 ;

    code32flat_start = 0xd5bc0 ;
    .text code32flat_start : {

        _reloc_abs_start = ABSOLUTE(.) ;
LONG(0xd7e8f - code32init_start)
LONG(0xd7ee7 - code32init_start)
LONG(0xd7eee - code32init_start)
LONG(0xd7f1a - code32init_start)
LONG(0xd7f21 - code32init_start)
LONG(0xd7f3a - code32init_start)
LONG(0xd7fd0 - code32init_start)
LONG(0xd8082 - code32init_start)
LONG(0xd808b - code32init_start)
LONG(0xd80be - code32init_start)
LONG(0xd80c7 - code32init_start)
LONG(0xd80db - code32init_start)
LONG(0xd80ec - code32init_start)
LONG(0xd80f7 - code32init_start)
LONG(0xd821e - code32init_start)
LONG(0xd8368 - code32init_start)
LONG(0xd8396 - code32init_start)
LONG(0xd83a2 - code32init_start)
LONG(0xd83dd - code32init_start)
LONG(0xd83ea - code32init_start)
LONG(0xd83fd - code32init_start)
LONG(0xd8407 - code32init_start)
LONG(0xd8411 - code32init_start)
LONG(0xd8415 - code32init_start)
LONG(0xd855a - code32init_start)
LONG(0xd8564 - code32init_start)
LONG(0xd8d0a - code32init_start)
LONG(0xd8d22 - code32init_start)
LONG(0xd8d34 - code32init_start)
LONG(0xd8d46 - code32init_start)
LONG(0xd8d58 - code32init_start)
LONG(0xd8d66 - code32init_start)
LONG(0xd8d76 - code32init_start)
LONG(0xd8d86 - code32init_start)
LONG(0xd9002 - code32init_start)
LONG(0xd957d - code32init_start)
LONG(0xd99f3 - code32init_start)
LONG(0xd9a1f - code32init_start)
LONG(0xd9a3a - code32init_start)
LONG(0xd9a9e - code32init_start)
LONG(0xd9acd - code32init_start)
LONG(0xd9b0d - code32init_start)
LONG(0xd9b61 - code32init_start)
LONG(0xd9dd0 - code32init_start)
LONG(0xd9dea - code32init_start)
LONG(0xd9df9 - code32init_start)
LONG(0xd9e97 - code32init_start)
LONG(0xd9ea8 - code32init_start)
LONG(0xd9eb9 - code32init_start)
LONG(0xd9ec5 - code32init_start)
LONG(0xd9ed6 - code32init_start)
LONG(0xd9f0a - code32init_start)
LONG(0xd9f1c - code32init_start)
LONG(0xd9f3e - code32init_start)
LONG(0xd9f66 - code32init_start)
LONG(0xd9fa4 - code32init_start)
LONG(0xda04c - code32init_start)
LONG(0xda05c - code32init_start)
LONG(0xda08e - code32init_start)
LONG(0xda113 - code32init_start)
LONG(0xda136 - code32init_start)
LONG(0xda15a - code32init_start)
LONG(0xda1a4 - code32init_start)
LONG(0xda201 - code32init_start)
LONG(0xda22a - code32init_start)
LONG(0xda231 - code32init_start)
LONG(0xda282 - code32init_start)
LONG(0xda2bd - code32init_start)
LONG(0xda306 - code32init_start)
LONG(0xda30b - code32init_start)
LONG(0xda313 - code32init_start)
LONG(0xda356 - code32init_start)
LONG(0xda40f - code32init_start)
LONG(0xda443 - code32init_start)
LONG(0xda4c6 - code32init_start)
LONG(0xda4d7 - code32init_start)
LONG(0xda538 - code32init_start)
LONG(0xda549 - code32init_start)
LONG(0xda599 - code32init_start)
LONG(0xda5ec - code32init_start)
LONG(0xda6f9 - code32init_start)
LONG(0xda738 - code32init_start)
LONG(0xda7aa - code32init_start)
LONG(0xda854 - code32init_start)
LONG(0xda882 - code32init_start)
LONG(0xda952 - code32init_start)
LONG(0xda9c4 - code32init_start)
LONG(0xdaa62 - code32init_start)
LONG(0xdaaed - code32init_start)
LONG(0xdab43 - code32init_start)
LONG(0xdacb9 - code32init_start)
LONG(0xdacc7 - code32init_start)
LONG(0xdad35 - code32init_start)
LONG(0xdadda - code32init_start)
LONG(0xdae0e - code32init_start)
LONG(0xdae1e - code32init_start)
LONG(0xdae44 - code32init_start)
LONG(0xdaedb - code32init_start)
LONG(0xdaf46 - code32init_start)
LONG(0xdaf90 - code32init_start)
LONG(0xdafa0 - code32init_start)
LONG(0xdb054 - code32init_start)
LONG(0xdb0a0 - code32init_start)
LONG(0xdb2ed - code32init_start)
LONG(0xdb33f - code32init_start)
LONG(0xdb349 - code32init_start)
LONG(0xdb388 - code32init_start)
LONG(0xdb38e - code32init_start)
LONG(0xdb3b8 - code32init_start)
LONG(0xdb3ca - code32init_start)
LONG(0xdb3cf - code32init_start)
LONG(0xdb3f3 - code32init_start)
LONG(0xdb433 - code32init_start)
LONG(0xdb596 - code32init_start)
LONG(0xdb62e - code32init_start)
LONG(0xdb85f - code32init_start)
LONG(0xdba21 - code32init_start)
LONG(0xdbb09 - code32init_start)
LONG(0xdbd3c - code32init_start)
LONG(0xdbe22 - code32init_start)
LONG(0xdbe5b - code32init_start)
LONG(0xdbfbc - code32init_start)
LONG(0xdc080 - code32init_start)
LONG(0xdc223 - code32init_start)
LONG(0xdc2a1 - code32init_start)
LONG(0xdc35c - code32init_start)
LONG(0xdc3c8 - code32init_start)
LONG(0xdc3d8 - code32init_start)
LONG(0xdc45c - code32init_start)
LONG(0xdc77f - code32init_start)
LONG(0xdc812 - code32init_start)
LONG(0xdc88f - code32init_start)
LONG(0xdc8c4 - code32init_start)
LONG(0xdc922 - code32init_start)
LONG(0xdc949 - code32init_start)
LONG(0xdc970 - code32init_start)
LONG(0xdca0c - code32init_start)
LONG(0xdca2e - code32init_start)
LONG(0xdca6e - code32init_start)
LONG(0xdca78 - code32init_start)
LONG(0xdca82 - code32init_start)
LONG(0xdca86 - code32init_start)
LONG(0xdca9c - code32init_start)
LONG(0xdcaa7 - code32init_start)
LONG(0xdcaad - code32init_start)
LONG(0xdcae1 - code32init_start)
LONG(0xdcafa - code32init_start)
LONG(0xdcb02 - code32init_start)
LONG(0xdcb43 - code32init_start)
LONG(0xdcc75 - code32init_start)
LONG(0xdcf0b - code32init_start)
LONG(0xdcfb2 - code32init_start)
LONG(0xdd216 - code32init_start)
LONG(0xdd34d - code32init_start)
LONG(0xdd354 - code32init_start)
LONG(0xdd3d0 - code32init_start)
LONG(0xdd44c - code32init_start)
LONG(0xdd453 - code32init_start)
LONG(0xdd7ed - code32init_start)
LONG(0xdd825 - code32init_start)
LONG(0xdd82f - code32init_start)
LONG(0xdd867 - code32init_start)
LONG(0xddb59 - code32init_start)
LONG(0xddb9d - code32init_start)
LONG(0xddba4 - code32init_start)
LONG(0xddbaa - code32init_start)
LONG(0xddbbc - code32init_start)
LONG(0xddbc2 - code32init_start)
LONG(0xddc79 - code32init_start)
LONG(0xddc7f - code32init_start)
LONG(0xddc95 - code32init_start)
LONG(0xddc9b - code32init_start)
LONG(0xddd2f - code32init_start)
LONG(0xddd51 - code32init_start)
LONG(0xddd8f - code32init_start)
LONG(0xddd9a - code32init_start)
LONG(0xddda2 - code32init_start)
LONG(0xddfc4 - code32init_start)
LONG(0xddfce - code32init_start)
LONG(0xddfd8 - code32init_start)
LONG(0xddfe2 - code32init_start)
LONG(0xde066 - code32init_start)
LONG(0xde076 - code32init_start)
LONG(0xde080 - code32init_start)
LONG(0xde08a - code32init_start)
LONG(0xde0bc - code32init_start)
LONG(0xde0e8 - code32init_start)
LONG(0xde0ed - code32init_start)
LONG(0xde0fa - code32init_start)
LONG(0xde103 - code32init_start)
LONG(0xde11a - code32init_start)
LONG(0xde132 - code32init_start)
LONG(0xde189 - code32init_start)
LONG(0xde1b5 - code32init_start)
LONG(0xde1ba - code32init_start)
LONG(0xde1c7 - code32init_start)
LONG(0xde1d0 - code32init_start)
LONG(0xde1e7 - code32init_start)
LONG(0xde203 - code32init_start)
LONG(0xde5f2 - code32init_start)
LONG(0xde605 - code32init_start)
LONG(0xde667 - code32init_start)
LONG(0xde96f - code32init_start)
LONG(0xdeaaa - code32init_start)
LONG(0xdeddb - code32init_start)
LONG(0xdee85 - code32init_start)
LONG(0xdee99 - code32init_start)
LONG(0xdeeaa - code32init_start)
LONG(0xdfe75 - code32init_start)
LONG(0xdfef9 - code32init_start)
LONG(0xe003b - code32init_start)
LONG(0xe01be - code32init_start)
LONG(0xe03bc - code32init_start)
LONG(0xe0484 - code32init_start)
LONG(0xe04a2 - code32init_start)
LONG(0xe04d4 - code32init_start)
LONG(0xe0607 - code32init_start)
LONG(0xe0610 - code32init_start)
LONG(0xe0620 - code32init_start)
LONG(0xe06cf - code32init_start)
LONG(0xe06e8 - code32init_start)
LONG(0xe074b - code32init_start)
LONG(0xe08ce - code32init_start)
LONG(0xe08fe - code32init_start)
LONG(0xe097d - code32init_start)
LONG(0xe099b - code32init_start)
LONG(0xe09c3 - code32init_start)
LONG(0xe0a23 - code32init_start)
LONG(0xe0a87 - code32init_start)
LONG(0xe0ae2 - code32init_start)
LONG(0xe0b6e - code32init_start)
LONG(0xe0bc9 - code32init_start)
LONG(0xe0c00 - code32init_start)
LONG(0xe0c05 - code32init_start)
LONG(0xe0c54 - code32init_start)
LONG(0xe0df7 - code32init_start)
LONG(0xe0e0c - code32init_start)
LONG(0xe0e5a - code32init_start)
LONG(0xe0e9f - code32init_start)
LONG(0xe0eb9 - code32init_start)
LONG(0xe0ed1 - code32init_start)
LONG(0xe0f22 - code32init_start)
LONG(0xe0f93 - code32init_start)
LONG(0xe0fab - code32init_start)
LONG(0xe0ff2 - code32init_start)
LONG(0xe1042 - code32init_start)
LONG(0xe1098 - code32init_start)
LONG(0xe111f - code32init_start)
LONG(0xe1124 - code32init_start)
LONG(0xe116f - code32init_start)
LONG(0xe11a6 - code32init_start)
LONG(0xe1200 - code32init_start)
LONG(0xe128b - code32init_start)
LONG(0xe12f2 - code32init_start)
LONG(0xe1378 - code32init_start)
LONG(0xe13af - code32init_start)
LONG(0xe13e8 - code32init_start)
LONG(0xe1405 - code32init_start)
LONG(0xe1442 - code32init_start)
LONG(0xe1456 - code32init_start)
LONG(0xe146c - code32init_start)
LONG(0xe14b3 - code32init_start)
LONG(0xe14cc - code32init_start)
LONG(0xe1513 - code32init_start)
LONG(0xe1525 - code32init_start)
LONG(0xe153d - code32init_start)
LONG(0xe154f - code32init_start)
LONG(0xe1567 - code32init_start)
LONG(0xe1579 - code32init_start)
LONG(0xe15da - code32init_start)
LONG(0xe15ec - code32init_start)
LONG(0xe1604 - code32init_start)
LONG(0xe1616 - code32init_start)
LONG(0xe1641 - code32init_start)
LONG(0xe1653 - code32init_start)
LONG(0xe1670 - code32init_start)
LONG(0xe17d3 - code32init_start)
LONG(0xe1800 - code32init_start)
LONG(0xe181d - code32init_start)
LONG(0xe186b - code32init_start)
LONG(0xe18c8 - code32init_start)
LONG(0xe1921 - code32init_start)
LONG(0xe1969 - code32init_start)
LONG(0xe19a0 - code32init_start)
LONG(0xe19af - code32init_start)
LONG(0xe19b5 - code32init_start)
LONG(0xe19cb - code32init_start)
LONG(0xe19d1 - code32init_start)
LONG(0xe19e3 - code32init_start)
LONG(0xe19e9 - code32init_start)
LONG(0xe1a74 - code32init_start)
LONG(0xe1b83 - code32init_start)
LONG(0xe1bd8 - code32init_start)
LONG(0xe1c5d - code32init_start)
LONG(0xe1dad - code32init_start)
LONG(0xe1e63 - code32init_start)
LONG(0xe1f99 - code32init_start)
LONG(0xe2176 - code32init_start)
LONG(0xe21eb - code32init_start)
LONG(0xe2235 - code32init_start)
LONG(0xe2263 - code32init_start)
LONG(0xe226f - code32init_start)
LONG(0xe22ba - code32init_start)
LONG(0xe238d - code32init_start)
LONG(0xe24b4 - code32init_start)
LONG(0xe24b9 - code32init_start)
LONG(0xe2509 - code32init_start)
LONG(0xe2598 - code32init_start)
LONG(0xe25f0 - code32init_start)
LONG(0xe2609 - code32init_start)
LONG(0xe267e - code32init_start)
LONG(0xe270f - code32init_start)
LONG(0xe2734 - code32init_start)
LONG(0xe28b5 - code32init_start)
LONG(0xe28c1 - code32init_start)
LONG(0xe28ea - code32init_start)
LONG(0xe2991 - code32init_start)
LONG(0xe2996 - code32init_start)
LONG(0xe299c - code32init_start)
LONG(0xe29a5 - code32init_start)
LONG(0xe29de - code32init_start)
LONG(0xe2a11 - code32init_start)
LONG(0xe2a44 - code32init_start)
LONG(0xe2ee6 - code32init_start)
LONG(0xe301b - code32init_start)
LONG(0xe3072 - code32init_start)
LONG(0xe3078 - code32init_start)
LONG(0xe3098 - code32init_start)
LONG(0xe30b1 - code32init_start)
LONG(0xe30be - code32init_start)
LONG(0xe31cb - code32init_start)
LONG(0xe3209 - code32init_start)
LONG(0xe3266 - code32init_start)
LONG(0xe330c - code32init_start)
LONG(0xe3312 - code32init_start)
LONG(0xe3321 - code32init_start)
LONG(0xe3327 - code32init_start)
LONG(0xe33d1 - code32init_start)
LONG(0xe33df - code32init_start)
LONG(0xe33ea - code32init_start)
LONG(0xe33ef - code32init_start)
LONG(0xe3409 - code32init_start)
LONG(0xe3520 - code32init_start)
LONG(0xe35b1 - code32init_start)
LONG(0xe3809 - code32init_start)
LONG(0xe38c6 - code32init_start)
LONG(0xe3a26 - code32init_start)
LONG(0xe4009 - code32init_start)
LONG(0xe4011 - code32init_start)
LONG(0xe4017 - code32init_start)
LONG(0xe4175 - code32init_start)
LONG(0xe41ba - code32init_start)
LONG(0xe41c0 - code32init_start)
LONG(0xe41e7 - code32init_start)
LONG(0xe41ed - code32init_start)
LONG(0xe425b - code32init_start)
LONG(0xe42a7 - code32init_start)
LONG(0xe42ad - code32init_start)
LONG(0xe4306 - code32init_start)
LONG(0xe440d - code32init_start)
LONG(0xe4480 - code32init_start)
LONG(0xe454d - code32init_start)
LONG(0xe4577 - code32init_start)
LONG(0xe45f2 - code32init_start)
LONG(0xe45f9 - code32init_start)
LONG(0xe464a - code32init_start)
LONG(0xe468b - code32init_start)
LONG(0xe4730 - code32init_start)
LONG(0xe4784 - code32init_start)
LONG(0xe4864 - code32init_start)
LONG(0xe486b - code32init_start)
LONG(0xe48ca - code32init_start)
LONG(0xe48ed - code32init_start)
LONG(0xe48f4 - code32init_start)
LONG(0xe492a - code32init_start)
LONG(0xe49a8 - code32init_start)
LONG(0xe4a07 - code32init_start)
LONG(0xe4a0d - code32init_start)
LONG(0xe4ace - code32init_start)
LONG(0xe4ad4 - code32init_start)
LONG(0xe4b98 - code32init_start)
LONG(0xe4b9e - code32init_start)
LONG(0xe4bc0 - code32init_start)
LONG(0xe4bc6 - code32init_start)
LONG(0xe4bff - code32init_start)
LONG(0xe4c09 - code32init_start)
LONG(0xe4c7a - code32init_start)
LONG(0xe4c92 - code32init_start)
LONG(0xe4dca - code32init_start)
LONG(0xe4fd5 - code32init_start)
LONG(0xe50a9 - code32init_start)
LONG(0xe50e4 - code32init_start)
LONG(0xe5260 - code32init_start)
LONG(0xe56ef - code32init_start)
LONG(0xe5850 - code32init_start)
LONG(0xe5b38 - code32init_start)
LONG(0xe5bce - code32init_start)
LONG(0xe5ce1 - code32init_start)
LONG(0xe5e0a - code32init_start)
LONG(0xe5e4f - code32init_start)
LONG(0xe5f34 - code32init_start)
LONG(0xe6316 - code32init_start)
LONG(0xe645a - code32init_start)
LONG(0xe6563 - code32init_start)
LONG(0xe66f0 - code32init_start)
LONG(0xe6933 - code32init_start)
LONG(0xe6b3d - code32init_start)
LONG(0xe6bea - code32init_start)
LONG(0xe6cf9 - code32init_start)
LONG(0xe6d40 - code32init_start)
LONG(0xe6e0d - code32init_start)
LONG(0xe6ecb - code32init_start)
LONG(0xe6f17 - code32init_start)
LONG(0xe6f28 - code32init_start)
LONG(0xe718e - code32init_start)
LONG(0xe729d - code32init_start)
LONG(0xe72fe - code32init_start)
LONG(0xe738d - code32init_start)
LONG(0xe7481 - code32init_start)
LONG(0xe7947 - code32init_start)
LONG(0xe7b5a - code32init_start)
LONG(0xe7b8e - code32init_start)
LONG(0xe7c2b - code32init_start)
LONG(0xe7c5d - code32init_start)
LONG(0xe7da7 - code32init_start)
LONG(0xe7e17 - code32init_start)
LONG(0xe7e95 - code32init_start)
LONG(0xe7f09 - code32init_start)
LONG(0xe8013 - code32init_start)
LONG(0xe80da - code32init_start)
LONG(0xe80f2 - code32init_start)
LONG(0xe810b - code32init_start)
LONG(0xe81b1 - code32init_start)
LONG(0xe85b4 - code32init_start)
LONG(0xe8778 - code32init_start)
LONG(0xe8882 - code32init_start)
LONG(0xe88c8 - code32init_start)
LONG(0xe88d1 - code32init_start)
LONG(0xe8903 - code32init_start)
LONG(0xe892c - code32init_start)
LONG(0xe8f7c - code32init_start)
LONG(0xe8f9a - code32init_start)
LONG(0xe8fcf - code32init_start)
LONG(0xe8ff4 - code32init_start)
LONG(0xe91b2 - code32init_start)
LONG(0xe91f2 - code32init_start)
LONG(0xe9625 - code32init_start)
LONG(0xe9660 - code32init_start)
LONG(0xe9681 - code32init_start)
LONG(0xe96d5 - code32init_start)
LONG(0xe9722 - code32init_start)
LONG(0xe974d - code32init_start)
LONG(0xe975c - code32init_start)
LONG(0xe97ed - code32init_start)
LONG(0xe9923 - code32init_start)
LONG(0xe9c55 - code32init_start)
LONG(0xe9c7f - code32init_start)
LONG(0xe9cfc - code32init_start)
LONG(0xe9d12 - code32init_start)
LONG(0xe9d59 - code32init_start)
LONG(0xe9e01 - code32init_start)
LONG(0xe9e16 - code32init_start)
LONG(0xe9e75 - code32init_start)
LONG(0xe9e7a - code32init_start)
LONG(0xe9e81 - code32init_start)
LONG(0xe9e86 - code32init_start)
LONG(0xe9f3e - code32init_start)
LONG(0xe9fbe - code32init_start)
LONG(0xe9ff0 - code32init_start)
LONG(0xe9ff4 - code32init_start)
LONG(0xe9ff8 - code32init_start)
LONG(0xe9ffc - code32init_start)
LONG(0xea000 - code32init_start)
LONG(0xea004 - code32init_start)
LONG(0xea008 - code32init_start)
LONG(0xea00c - code32init_start)
LONG(0xea010 - code32init_start)
LONG(0xea014 - code32init_start)
LONG(0xea018 - code32init_start)
LONG(0xea01c - code32init_start)
LONG(0xea020 - code32init_start)
LONG(0xea024 - code32init_start)
LONG(0xeaa50 - code32init_start)
LONG(0xeaa64 - code32init_start)
LONG(0xebbd0 - code32init_start)
LONG(0xebbe4 - code32init_start)
LONG(0xebc10 - code32init_start)
LONG(0xebc24 - code32init_start)
LONG(0xebc38 - code32init_start)
LONG(0xebc4c - code32init_start)
LONG(0xebc60 - code32init_start)
LONG(0xebc74 - code32init_start)
LONG(0xebc88 - code32init_start)
LONG(0xebc9c - code32init_start)
LONG(0xebcb0 - code32init_start)
LONG(0xebcc4 - code32init_start)
LONG(0xebcd8 - code32init_start)
LONG(0xebcec - code32init_start)
LONG(0xebd00 - code32init_start)
LONG(0xebe70 - code32init_start)
LONG(0xebe84 - code32init_start)
LONG(0xec018 - code32init_start)
LONG(0xec040 - code32init_start)
LONG(0xec044 - code32init_start)
LONG(0xec04c - code32init_start)
LONG(0xec050 - code32init_start)
LONG(0xec054 - code32init_start)
LONG(0xec058 - code32init_start)
LONG(0xec05c - code32init_start)
LONG(0xec0e4 - code32init_start)
LONG(0xec0e8 - code32init_start)
LONG(0xec0ec - code32init_start)
LONG(0xec0f0 - code32init_start)
LONG(0xec0f4 - code32init_start)
LONG(0xec124 - code32init_start)
LONG(0xec128 - code32init_start)
LONG(0xec130 - code32init_start)
LONG(0xec134 - code32init_start)
LONG(0xec138 - code32init_start)
LONG(0xec140 - code32init_start)
LONG(0xec144 - code32init_start)
LONG(0xec148 - code32init_start)
LONG(0xec150 - code32init_start)
        _reloc_abs_end = ABSOLUTE(.) ;
        _reloc_rel_start = ABSOLUTE(.) ;
LONG(0xd7b92 - code32init_start)
LONG(0xd7bd0 - code32init_start)
LONG(0xd7beb - code32init_start)
LONG(0xd7c0c - code32init_start)
LONG(0xd7c1f - code32init_start)
LONG(0xd7f4c - code32init_start)
LONG(0xd7fc8 - code32init_start)
LONG(0xd8138 - code32init_start)
LONG(0xd83b9 - code32init_start)
LONG(0xd83cb - code32init_start)
LONG(0xd83d8 - code32init_start)
LONG(0xd8669 - code32init_start)
LONG(0xd867a - code32init_start)
LONG(0xd868e - code32init_start)
LONG(0xd869f - code32init_start)
LONG(0xd86b5 - code32init_start)
LONG(0xd8777 - code32init_start)
LONG(0xd8791 - code32init_start)
LONG(0xd9031 - code32init_start)
LONG(0xd906f - code32init_start)
LONG(0xd9082 - code32init_start)
LONG(0xd9097 - code32init_start)
LONG(0xd90ac - code32init_start)
LONG(0xd90c5 - code32init_start)
LONG(0xd90f0 - code32init_start)
LONG(0xd911f - code32init_start)
LONG(0xd913f - code32init_start)
LONG(0xd9165 - code32init_start)
LONG(0xd9179 - code32init_start)
LONG(0xd91f4 - code32init_start)
LONG(0xd9208 - code32init_start)
LONG(0xd924c - code32init_start)
LONG(0xd9269 - code32init_start)
LONG(0xd92c3 - code32init_start)
LONG(0xd92ef - code32init_start)
LONG(0xd9302 - code32init_start)
LONG(0xd931b - code32init_start)
LONG(0xd9333 - code32init_start)
LONG(0xd9381 - code32init_start)
LONG(0xd93f0 - code32init_start)
LONG(0xd945c - code32init_start)
LONG(0xd9520 - code32init_start)
LONG(0xd954b - code32init_start)
LONG(0xd9574 - code32init_start)
LONG(0xd96b0 - code32init_start)
LONG(0xd96c5 - code32init_start)
LONG(0xd96d7 - code32init_start)
LONG(0xd96e9 - code32init_start)
LONG(0xd96fc - code32init_start)
LONG(0xd970e - code32init_start)
LONG(0xd971f - code32init_start)
LONG(0xd972f - code32init_start)
LONG(0xd9746 - code32init_start)
LONG(0xd9763 - code32init_start)
LONG(0xd9772 - code32init_start)
LONG(0xd9777 - code32init_start)
LONG(0xd979b - code32init_start)
LONG(0xd97d5 - code32init_start)
LONG(0xd9837 - code32init_start)
LONG(0xd9847 - code32init_start)
LONG(0xd9858 - code32init_start)
LONG(0xd986e - code32init_start)
LONG(0xd9877 - code32init_start)
LONG(0xd9880 - code32init_start)
LONG(0xd9946 - code32init_start)
LONG(0xd9960 - code32init_start)
LONG(0xd9977 - code32init_start)
LONG(0xd998e - code32init_start)
LONG(0xd99a0 - code32init_start)
LONG(0xd99c9 - code32init_start)
LONG(0xd99fd - code32init_start)
LONG(0xd9a16 - code32init_start)
LONG(0xd9a44 - code32init_start)
LONG(0xd9a8e - code32init_start)
LONG(0xd9aa9 - code32init_start)
LONG(0xd9ad7 - code32init_start)
LONG(0xd9b19 - code32init_start)
LONG(0xd9b71 - code32init_start)
LONG(0xd9e03 - code32init_start)
LONG(0xd9ef8 - code32init_start)
LONG(0xda066 - code32init_start)
LONG(0xda074 - code32init_start)
LONG(0xda118 - code32init_start)
LONG(0xda140 - code32init_start)
LONG(0xda14e - code32init_start)
LONG(0xda16d - code32init_start)
LONG(0xda1ae - code32init_start)
LONG(0xda210 - code32init_start)
LONG(0xda2cc - code32init_start)
LONG(0xda2da - code32init_start)
LONG(0xda360 - code32init_start)
LONG(0xda371 - code32init_start)
LONG(0xda419 - code32init_start)
LONG(0xda44d - code32init_start)
LONG(0xda45b - code32init_start)
LONG(0xda4a1 - code32init_start)
LONG(0xda4e1 - code32init_start)
LONG(0xda513 - code32init_start)
LONG(0xda553 - code32init_start)
LONG(0xda600 - code32init_start)
LONG(0xda60e - code32init_start)
LONG(0xda61d - code32init_start)
LONG(0xda62c - code32init_start)
LONG(0xda6a7 - code32init_start)
LONG(0xda6c1 - code32init_start)
LONG(0xda6f1 - code32init_start)
LONG(0xda703 - code32init_start)
LONG(0xda72e - code32init_start)
LONG(0xda742 - code32init_start)
LONG(0xda7b4 - code32init_start)
LONG(0xda7c7 - code32init_start)
LONG(0xda7e3 - code32init_start)
LONG(0xda7fd - code32init_start)
LONG(0xda85c - code32init_start)
LONG(0xda86e - code32init_start)
LONG(0xda8bd - code32init_start)
LONG(0xda92f - code32init_start)
LONG(0xda949 - code32init_start)
LONG(0xda95c - code32init_start)
LONG(0xda974 - code32init_start)
LONG(0xda9ce - code32init_start)
LONG(0xda9e1 - code32init_start)
LONG(0xda9ef - code32init_start)
LONG(0xdaa3c - code32init_start)
LONG(0xdaa59 - code32init_start)
LONG(0xdaa6c - code32init_start)
LONG(0xdaaf5 - code32init_start)
LONG(0xdab2d - code32init_start)
LONG(0xdab74 - code32init_start)
LONG(0xdac0b - code32init_start)
LONG(0xdac1b - code32init_start)
LONG(0xdac48 - code32init_start)
LONG(0xdac6d - code32init_start)
LONG(0xdac7b - code32init_start)
LONG(0xdac8f - code32init_start)
LONG(0xdacbe - code32init_start)
LONG(0xdacd1 - code32init_start)
LONG(0xdacdb - code32init_start)
LONG(0xdacfb - code32init_start)
LONG(0xdad0b - code32init_start)
LONG(0xdad24 - code32init_start)
LONG(0xdad2b - code32init_start)
LONG(0xdad3f - code32init_start)
LONG(0xdad46 - code32init_start)
LONG(0xdad58 - code32init_start)
LONG(0xdad66 - code32init_start)
LONG(0xdad7a - code32init_start)
LONG(0xdadc0 - code32init_start)
LONG(0xdadd1 - code32init_start)
LONG(0xdade4 - code32init_start)
LONG(0xdadee - code32init_start)
LONG(0xdae28 - code32init_start)
LONG(0xdae3b - code32init_start)
LONG(0xdae4e - code32init_start)
LONG(0xdae62 - code32init_start)
LONG(0xdae6b - code32init_start)
LONG(0xdaeb0 - code32init_start)
LONG(0xdaec6 - code32init_start)
LONG(0xdaed2 - code32init_start)
LONG(0xdaee5 - code32init_start)
LONG(0xdaf50 - code32init_start)
LONG(0xdaf6c - code32init_start)
LONG(0xdaf87 - code32init_start)
LONG(0xdaf9a - code32init_start)
LONG(0xdafaa - code32init_start)
LONG(0xdafc4 - code32init_start)
LONG(0xdb00d - code32init_start)
LONG(0xdb08d - code32init_start)
LONG(0xdb0d6 - code32init_start)
LONG(0xdb185 - code32init_start)
LONG(0xdb1a6 - code32init_start)
LONG(0xdb1c9 - code32init_start)
LONG(0xdb206 - code32init_start)
LONG(0xdb219 - code32init_start)
LONG(0xdb225 - code32init_start)
LONG(0xdb25e - code32init_start)
LONG(0xdb29a - code32init_start)
LONG(0xdb2f7 - code32init_start)
LONG(0xdb30e - code32init_start)
LONG(0xdb31e - code32init_start)
LONG(0xdb33a - code32init_start)
LONG(0xdb382 - code32init_start)
LONG(0xdb3ea - code32init_start)
LONG(0xdb40b - code32init_start)
LONG(0xdb419 - code32init_start)
LONG(0xdb43d - code32init_start)
LONG(0xdb47e - code32init_start)
LONG(0xdb4e2 - code32init_start)
LONG(0xdb501 - code32init_start)
LONG(0xdb513 - code32init_start)
LONG(0xdb527 - code32init_start)
LONG(0xdb54e - code32init_start)
LONG(0xdb55c - code32init_start)
LONG(0xdb56e - code32init_start)
LONG(0xdb57e - code32init_start)
LONG(0xdb5a0 - code32init_start)
LONG(0xdb5b1 - code32init_start)
LONG(0xdb5c9 - code32init_start)
LONG(0xdb5e0 - code32init_start)
LONG(0xdb5ee - code32init_start)
LONG(0xdb5f7 - code32init_start)
LONG(0xdb605 - code32init_start)
LONG(0xdb61e - code32init_start)
LONG(0xdb638 - code32init_start)
LONG(0xdb644 - code32init_start)
LONG(0xdb65a - code32init_start)
LONG(0xdb668 - code32init_start)
LONG(0xdb678 - code32init_start)
LONG(0xdb686 - code32init_start)
LONG(0xdb6a9 - code32init_start)
LONG(0xdb6bc - code32init_start)
LONG(0xdb6cc - code32init_start)
LONG(0xdb6da - code32init_start)
LONG(0xdb6ef - code32init_start)
LONG(0xdb726 - code32init_start)
LONG(0xdb74a - code32init_start)
LONG(0xdb76c - code32init_start)
LONG(0xdb78b - code32init_start)
LONG(0xdb7a5 - code32init_start)
LONG(0xdb7b7 - code32init_start)
LONG(0xdb7d2 - code32init_start)
LONG(0xdb875 - code32init_start)
LONG(0xdb8b2 - code32init_start)
LONG(0xdb906 - code32init_start)
LONG(0xdb914 - code32init_start)
LONG(0xdb932 - code32init_start)
LONG(0xdb940 - code32init_start)
LONG(0xdb966 - code32init_start)
LONG(0xdb984 - code32init_start)
LONG(0xdb9a7 - code32init_start)
LONG(0xdb9c5 - code32init_start)
LONG(0xdb9d5 - code32init_start)
LONG(0xdb9e5 - code32init_start)
LONG(0xdba44 - code32init_start)
LONG(0xdba70 - code32init_start)
LONG(0xdba98 - code32init_start)
LONG(0xdbaa6 - code32init_start)
LONG(0xdbad7 - code32init_start)
LONG(0xdbaf2 - code32init_start)
LONG(0xdbb1b - code32init_start)
LONG(0xdbb5e - code32init_start)
LONG(0xdbb8a - code32init_start)
LONG(0xdbb98 - code32init_start)
LONG(0xdbbaf - code32init_start)
LONG(0xdbbee - code32init_start)
LONG(0xdbc85 - code32init_start)
LONG(0xdbcc6 - code32init_start)
LONG(0xdbcd9 - code32init_start)
LONG(0xdbd5c - code32init_start)
LONG(0xdbd66 - code32init_start)
LONG(0xdbd92 - code32init_start)
LONG(0xdbd9f - code32init_start)
LONG(0xdbdf1 - code32init_start)
LONG(0xdbe3c - code32init_start)
LONG(0xdbe65 - code32init_start)
LONG(0xdbe76 - code32init_start)
LONG(0xdbecb - code32init_start)
LONG(0xdbee2 - code32init_start)
LONG(0xdbefd - code32init_start)
LONG(0xdbf14 - code32init_start)
LONG(0xdbf3f - code32init_start)
LONG(0xdbf79 - code32init_start)
LONG(0xdbfa1 - code32init_start)
LONG(0xdbfc6 - code32init_start)
LONG(0xdbfd4 - code32init_start)
LONG(0xdc08a - code32init_start)
LONG(0xdc0a2 - code32init_start)
LONG(0xdc0b1 - code32init_start)
LONG(0xdc0c0 - code32init_start)
LONG(0xdc0cf - code32init_start)
LONG(0xdc22d - code32init_start)
LONG(0xdc28e - code32init_start)
LONG(0xdc2bb - code32init_start)
LONG(0xdc393 - code32init_start)
LONG(0xdc3a9 - code32init_start)
LONG(0xdc3e8 - code32init_start)
LONG(0xdc408 - code32init_start)
LONG(0xdc425 - code32init_start)
LONG(0xdc466 - code32init_start)
LONG(0xdc479 - code32init_start)
LONG(0xdc4a8 - code32init_start)
LONG(0xdc4c1 - code32init_start)
LONG(0xdc4e1 - code32init_start)
LONG(0xdc4f2 - code32init_start)
LONG(0xdc50a - code32init_start)
LONG(0xdc532 - code32init_start)
LONG(0xdc556 - code32init_start)
LONG(0xdc564 - code32init_start)
LONG(0xdc622 - code32init_start)
LONG(0xdc637 - code32init_start)
LONG(0xdc652 - code32init_start)
LONG(0xdc667 - code32init_start)
LONG(0xdc685 - code32init_start)
LONG(0xdc69a - code32init_start)
LONG(0xdc6af - code32init_start)
LONG(0xdc6c0 - code32init_start)
LONG(0xdc6e4 - code32init_start)
LONG(0xdc729 - code32init_start)
LONG(0xdc73b - code32init_start)
LONG(0xdc769 - code32init_start)
LONG(0xdc78c - code32init_start)
LONG(0xdc798 - code32init_start)
LONG(0xdc7cc - code32init_start)
LONG(0xdc7fe - code32init_start)
LONG(0xdc823 - code32init_start)
LONG(0xdc832 - code32init_start)
LONG(0xdc84b - code32init_start)
LONG(0xdc89d - code32init_start)
LONG(0xdc8a9 - code32init_start)
LONG(0xdc8e2 - code32init_start)
LONG(0xdc90c - code32init_start)
LONG(0xdc92f - code32init_start)
LONG(0xdc93b - code32init_start)
LONG(0xdc9a5 - code32init_start)
LONG(0xdc9e9 - code32init_start)
LONG(0xdca03 - code32init_start)
LONG(0xdca16 - code32init_start)
LONG(0xdca1d - code32init_start)
LONG(0xdca53 - code32init_start)
LONG(0xdcaf2 - code32init_start)
LONG(0xdcb3c - code32init_start)
LONG(0xdcb66 - code32init_start)
LONG(0xdcc1a - code32init_start)
LONG(0xdcc4a - code32init_start)
LONG(0xdcc62 - code32init_start)
LONG(0xdcc6c - code32init_start)
LONG(0xdcc7f - code32init_start)
LONG(0xdcc89 - code32init_start)
LONG(0xdcc9f - code32init_start)
LONG(0xdcd01 - code32init_start)
LONG(0xdcec7 - code32init_start)
LONG(0xdcee3 - code32init_start)
LONG(0xdcefe - code32init_start)
LONG(0xdcf15 - code32init_start)
LONG(0xdcf1c - code32init_start)
LONG(0xdcf67 - code32init_start)
LONG(0xdcf7d - code32init_start)
LONG(0xdcf8d - code32init_start)
LONG(0xdcfac - code32init_start)
LONG(0xdd0de - code32init_start)
LONG(0xdd141 - code32init_start)
LONG(0xdd158 - code32init_start)
LONG(0xdd167 - code32init_start)
LONG(0xdd1ba - code32init_start)
LONG(0xdd1d1 - code32init_start)
LONG(0xdd1f3 - code32init_start)
LONG(0xdd22f - code32init_start)
LONG(0xdd3da - code32init_start)
LONG(0xdd4cf - code32init_start)
LONG(0xdd4e0 - code32init_start)
LONG(0xdd591 - code32init_start)
LONG(0xdd754 - code32init_start)
LONG(0xdd765 - code32init_start)
LONG(0xdd858 - code32init_start)
LONG(0xdd8a7 - code32init_start)
LONG(0xdd8c4 - code32init_start)
LONG(0xdd8d6 - code32init_start)
LONG(0xdd92d - code32init_start)
LONG(0xdd984 - code32init_start)
LONG(0xdd9a5 - code32init_start)
LONG(0xdd9db - code32init_start)
LONG(0xdd9fb - code32init_start)
LONG(0xdda1d - code32init_start)
LONG(0xdda8f - code32init_start)
LONG(0xddaaf - code32init_start)
LONG(0xddab8 - code32init_start)
LONG(0xddad2 - code32init_start)
LONG(0xddadb - code32init_start)
LONG(0xddb4e - code32init_start)
LONG(0xddbf4 - code32init_start)
LONG(0xddc11 - code32init_start)
LONG(0xddca5 - code32init_start)
LONG(0xddcce - code32init_start)
LONG(0xddcea - code32init_start)
LONG(0xddd5b - code32init_start)
LONG(0xddd69 - code32init_start)
LONG(0xddf3c - code32init_start)
LONG(0xddf5f - code32init_start)
LONG(0xde10d - code32init_start)
LONG(0xde12a - code32init_start)
LONG(0xde166 - code32init_start)
LONG(0xde1da - code32init_start)
LONG(0xde1fa - code32init_start)
LONG(0xde269 - code32init_start)
LONG(0xde28c - code32init_start)
LONG(0xde2b5 - code32init_start)
LONG(0xde2e0 - code32init_start)
LONG(0xde5fc - code32init_start)
LONG(0xde622 - code32init_start)
LONG(0xde652 - code32init_start)
LONG(0xde671 - code32init_start)
LONG(0xde684 - code32init_start)
LONG(0xde6d2 - code32init_start)
LONG(0xde71d - code32init_start)
LONG(0xde73a - code32init_start)
LONG(0xde767 - code32init_start)
LONG(0xde77c - code32init_start)
LONG(0xde791 - code32init_start)
LONG(0xde7b0 - code32init_start)
LONG(0xde7f4 - code32init_start)
LONG(0xde8c1 - code32init_start)
LONG(0xde919 - code32init_start)
LONG(0xde979 - code32init_start)
LONG(0xde98a - code32init_start)
LONG(0xde9cb - code32init_start)
LONG(0xde9fc - code32init_start)
LONG(0xdea41 - code32init_start)
LONG(0xdea5c - code32init_start)
LONG(0xdea7d - code32init_start)
LONG(0xdeaa1 - code32init_start)
LONG(0xdeab4 - code32init_start)
LONG(0xdeae6 - code32init_start)
LONG(0xdeb1c - code32init_start)
LONG(0xdeb4b - code32init_start)
LONG(0xdeba5 - code32init_start)
LONG(0xdec37 - code32init_start)
LONG(0xdecf7 - code32init_start)
LONG(0xded82 - code32init_start)
LONG(0xdedbc - code32init_start)
LONG(0xdee30 - code32init_start)
LONG(0xdee46 - code32init_start)
LONG(0xdee6e - code32init_start)
LONG(0xdee8f - code32init_start)
LONG(0xdf002 - code32init_start)
LONG(0xdfd14 - code32init_start)
LONG(0xdfd77 - code32init_start)
LONG(0xdfe14 - code32init_start)
LONG(0xdfe3c - code32init_start)
LONG(0xdfe6c - code32init_start)
LONG(0xdfe7f - code32init_start)
LONG(0xdfeb4 - code32init_start)
LONG(0xdff22 - code32init_start)
LONG(0xdff3a - code32init_start)
LONG(0xe0045 - code32init_start)
LONG(0xe0071 - code32init_start)
LONG(0xe01d4 - code32init_start)
LONG(0xe02d7 - code32init_start)
LONG(0xe03c6 - code32init_start)
LONG(0xe03e2 - code32init_start)
LONG(0xe04de - code32init_start)
LONG(0xe0501 - code32init_start)
LONG(0xe050e - code32init_start)
LONG(0xe051b - code32init_start)
LONG(0xe0636 - code32init_start)
LONG(0xe0701 - code32init_start)
LONG(0xe0755 - code32init_start)
LONG(0xe0766 - code32init_start)
LONG(0xe0908 - code32init_start)
LONG(0xe0942 - code32init_start)
LONG(0xe0987 - code32init_start)
LONG(0xe09a5 - code32init_start)
LONG(0xe09cd - code32init_start)
LONG(0xe0a91 - code32init_start)
LONG(0xe0aec - code32init_start)
LONG(0xe0b04 - code32init_start)
LONG(0xe0c5e - code32init_start)
LONG(0xe0c6f - code32init_start)
LONG(0xe0cf2 - code32init_start)
LONG(0xe0d6e - code32init_start)
LONG(0xe0daf - code32init_start)
LONG(0xe0dde - code32init_start)
LONG(0xe0e64 - code32init_start)
LONG(0xe0e72 - code32init_start)
LONG(0xe0eab - code32init_start)
LONG(0xe0f2c - code32init_start)
LONG(0xe0f3a - code32init_start)
LONG(0xe0f51 - code32init_start)
LONG(0xe0f6a - code32init_start)
LONG(0xe0f7e - code32init_start)
LONG(0xe0ffc - code32init_start)
LONG(0xe100a - code32init_start)
LONG(0xe1020 - code32init_start)
LONG(0xe111a - code32init_start)
LONG(0xe120a - code32init_start)
LONG(0xe1221 - code32init_start)
LONG(0xe1236 - code32init_start)
LONG(0xe129e - code32init_start)
LONG(0xe12fc - code32init_start)
LONG(0xe130a - code32init_start)
LONG(0xe1319 - code32init_start)
LONG(0xe1328 - code32init_start)
LONG(0xe1336 - code32init_start)
LONG(0xe1347 - code32init_start)
LONG(0xe135f - code32init_start)
LONG(0xe136f - code32init_start)
LONG(0xe1460 - code32init_start)
LONG(0xe14a8 - code32init_start)
LONG(0xe1508 - code32init_start)
LONG(0xe16ed - code32init_start)
LONG(0xe174b - code32init_start)
LONG(0xe17b2 - code32init_start)
LONG(0xe1875 - code32init_start)
LONG(0xe1894 - code32init_start)
LONG(0xe18b0 - code32init_start)
LONG(0xe192b - code32init_start)
LONG(0xe1be2 - code32init_start)
LONG(0xe1c67 - code32init_start)
LONG(0xe1c7d - code32init_start)
LONG(0xe1cfe - code32init_start)
LONG(0xe1d35 - code32init_start)
LONG(0xe1db7 - code32init_start)
LONG(0xe1dcd - code32init_start)
LONG(0xe1e6d - code32init_start)
LONG(0xe1e81 - code32init_start)
LONG(0xe1ec2 - code32init_start)
LONG(0xe1f08 - code32init_start)
LONG(0xe200f - code32init_start)
LONG(0xe2074 - code32init_start)
LONG(0xe20e1 - code32init_start)
LONG(0xe2180 - code32init_start)
LONG(0xe2196 - code32init_start)
LONG(0xe21f5 - code32init_start)
LONG(0xe223f - code32init_start)
LONG(0xe2290 - code32init_start)
LONG(0xe22c4 - code32init_start)
LONG(0xe22cf - code32init_start)
LONG(0xe22fb - code32init_start)
LONG(0xe232c - code32init_start)
LONG(0xe2455 - code32init_start)
LONG(0xe249c - code32init_start)
LONG(0xe24ae - code32init_start)
LONG(0xe252e - code32init_start)
LONG(0xe26bc - code32init_start)
LONG(0xe26d2 - code32init_start)
LONG(0xe26f9 - code32init_start)
LONG(0xe272a - code32init_start)
LONG(0xe276c - code32init_start)
LONG(0xe2796 - code32init_start)
LONG(0xe27a9 - code32init_start)
LONG(0xe27e8 - code32init_start)
LONG(0xe2889 - code32init_start)
LONG(0xe28cd - code32init_start)
LONG(0xe28d9 - code32init_start)
LONG(0xe291f - code32init_start)
LONG(0xe2945 - code32init_start)
LONG(0xe2987 - code32init_start)
LONG(0xe29f5 - code32init_start)
LONG(0xe2a1b - code32init_start)
LONG(0xe2a35 - code32init_start)
LONG(0xe2a3f - code32init_start)
LONG(0xe2ac9 - code32init_start)
LONG(0xe2ae0 - code32init_start)
LONG(0xe2b58 - code32init_start)
LONG(0xe2b61 - code32init_start)
LONG(0xe2b72 - code32init_start)
LONG(0xe2b85 - code32init_start)
LONG(0xe2b95 - code32init_start)
LONG(0xe2b9e - code32init_start)
LONG(0xe2baf - code32init_start)
LONG(0xe2d08 - code32init_start)
LONG(0xe2d7c - code32init_start)
LONG(0xe2d86 - code32init_start)
LONG(0xe2dba - code32init_start)
LONG(0xe2dcc - code32init_start)
LONG(0xe2df0 - code32init_start)
LONG(0xe2e07 - code32init_start)
LONG(0xe2e19 - code32init_start)
LONG(0xe2e2b - code32init_start)
LONG(0xe2e5c - code32init_start)
LONG(0xe2ef8 - code32init_start)
LONG(0xe2f82 - code32init_start)
LONG(0xe2f9a - code32init_start)
LONG(0xe2fa7 - code32init_start)
LONG(0xe2fb8 - code32init_start)
LONG(0xe3034 - code32init_start)
LONG(0xe3059 - code32init_start)
LONG(0xe3093 - code32init_start)
LONG(0xe30d4 - code32init_start)
LONG(0xe30f1 - code32init_start)
LONG(0xe3159 - code32init_start)
LONG(0xe3175 - code32init_start)
LONG(0xe32b4 - code32init_start)
LONG(0xe32d9 - code32init_start)
LONG(0xe33aa - code32init_start)
LONG(0xe33bb - code32init_start)
LONG(0xe33e4 - code32init_start)
LONG(0xe3413 - code32init_start)
LONG(0xe3424 - code32init_start)
LONG(0xe3471 - code32init_start)
LONG(0xe34cb - code32init_start)
LONG(0xe3537 - code32init_start)
LONG(0xe355b - code32init_start)
LONG(0xe3590 - code32init_start)
LONG(0xe35f8 - code32init_start)
LONG(0xe360f - code32init_start)
LONG(0xe3656 - code32init_start)
LONG(0xe36c5 - code32init_start)
LONG(0xe3755 - code32init_start)
LONG(0xe3768 - code32init_start)
LONG(0xe3789 - code32init_start)
LONG(0xe3813 - code32init_start)
LONG(0xe3868 - code32init_start)
LONG(0xe3874 - code32init_start)
LONG(0xe3880 - code32init_start)
LONG(0xe38d0 - code32init_start)
LONG(0xe38fd - code32init_start)
LONG(0xe393a - code32init_start)
LONG(0xe3969 - code32init_start)
LONG(0xe39a0 - code32init_start)
LONG(0xe39e8 - code32init_start)
LONG(0xe39fd - code32init_start)
LONG(0xe3a30 - code32init_start)
LONG(0xe3a45 - code32init_start)
LONG(0xe3b7a - code32init_start)
LONG(0xe3d35 - code32init_start)
LONG(0xe43a8 - code32init_start)
LONG(0xe448a - code32init_start)
LONG(0xe44aa - code32init_start)
LONG(0xe44fe - code32init_start)
LONG(0xe4510 - code32init_start)
LONG(0xe4557 - code32init_start)
LONG(0xe4581 - code32init_start)
LONG(0xe4778 - code32init_start)
LONG(0xe4875 - code32init_start)
LONG(0xe4892 - code32init_start)
LONG(0xe48a2 - code32init_start)
LONG(0xe48ad - code32init_start)
LONG(0xe48d4 - code32init_start)
LONG(0xe48fe - code32init_start)
LONG(0xe4934 - code32init_start)
LONG(0xe49b2 - code32init_start)
LONG(0xe49fa - code32init_start)
LONG(0xe4a17 - code32init_start)
LONG(0xe4bda - code32init_start)
LONG(0xe4c59 - code32init_start)
LONG(0xe4c68 - code32init_start)
LONG(0xe4c89 - code32init_start)
LONG(0xe4cfb - code32init_start)
LONG(0xe4d25 - code32init_start)
LONG(0xe4d87 - code32init_start)
LONG(0xe4ddb - code32init_start)
LONG(0xe4de7 - code32init_start)
LONG(0xe4f13 - code32init_start)
LONG(0xe4f36 - code32init_start)
LONG(0xe4f40 - code32init_start)
LONG(0xe4f8d - code32init_start)
LONG(0xe4fac - code32init_start)
LONG(0xe4fb6 - code32init_start)
LONG(0xe4fdf - code32init_start)
LONG(0xe500f - code32init_start)
LONG(0xe50b3 - code32init_start)
LONG(0xe519f - code32init_start)
LONG(0xe51b5 - code32init_start)
LONG(0xe51cb - code32init_start)
LONG(0xe51d5 - code32init_start)
LONG(0xe51e8 - code32init_start)
LONG(0xe51f7 - code32init_start)
LONG(0xe5204 - code32init_start)
LONG(0xe5215 - code32init_start)
LONG(0xe522a - code32init_start)
LONG(0xe5235 - code32init_start)
LONG(0xe5248 - code32init_start)
LONG(0xe5257 - code32init_start)
LONG(0xe526a - code32init_start)
LONG(0xe5278 - code32init_start)
LONG(0xe5285 - code32init_start)
LONG(0xe529b - code32init_start)
LONG(0xe52ac - code32init_start)
LONG(0xe52c5 - code32init_start)
LONG(0xe52ed - code32init_start)
LONG(0xe5302 - code32init_start)
LONG(0xe548c - code32init_start)
LONG(0xe54b2 - code32init_start)
LONG(0xe54d5 - code32init_start)
LONG(0xe54fd - code32init_start)
LONG(0xe5514 - code32init_start)
LONG(0xe552f - code32init_start)
LONG(0xe5546 - code32init_start)
LONG(0xe557b - code32init_start)
LONG(0xe55ee - code32init_start)
LONG(0xe5605 - code32init_start)
LONG(0xe5610 - code32init_start)
LONG(0xe5645 - code32init_start)
LONG(0xe565e - code32init_start)
LONG(0xe5688 - code32init_start)
LONG(0xe5726 - code32init_start)
LONG(0xe5768 - code32init_start)
LONG(0xe57e8 - code32init_start)
LONG(0xe57ff - code32init_start)
LONG(0xe581c - code32init_start)
LONG(0xe582b - code32init_start)
LONG(0xe5832 - code32init_start)
LONG(0xe5847 - code32init_start)
LONG(0xe585a - code32init_start)
LONG(0xe587c - code32init_start)
LONG(0xe592c - code32init_start)
LONG(0xe5987 - code32init_start)
LONG(0xe5a93 - code32init_start)
LONG(0xe5b42 - code32init_start)
LONG(0xe5bd8 - code32init_start)
LONG(0xe5c09 - code32init_start)
LONG(0xe5c1c - code32init_start)
LONG(0xe5c2c - code32init_start)
LONG(0xe5c42 - code32init_start)
LONG(0xe5c52 - code32init_start)
LONG(0xe5ceb - code32init_start)
LONG(0xe5cfd - code32init_start)
LONG(0xe5d0a - code32init_start)
LONG(0xe5d19 - code32init_start)
LONG(0xe5dce - code32init_start)
LONG(0xe5de7 - code32init_start)
LONG(0xe5e32 - code32init_start)
LONG(0xe5e59 - code32init_start)
LONG(0xe5eb6 - code32init_start)
LONG(0xe5f08 - code32init_start)
LONG(0xe5f94 - code32init_start)
LONG(0xe5faa - code32init_start)
LONG(0xe5fd6 - code32init_start)
LONG(0xe6075 - code32init_start)
LONG(0xe60df - code32init_start)
LONG(0xe60f0 - code32init_start)
LONG(0xe6105 - code32init_start)
LONG(0xe612c - code32init_start)
LONG(0xe613f - code32init_start)
LONG(0xe615b - code32init_start)
LONG(0xe616f - code32init_start)
LONG(0xe6194 - code32init_start)
LONG(0xe61c2 - code32init_start)
LONG(0xe61f3 - code32init_start)
LONG(0xe62af - code32init_start)
LONG(0xe6464 - code32init_start)
LONG(0xe6545 - code32init_start)
LONG(0xe65e7 - code32init_start)
LONG(0xe6628 - code32init_start)
LONG(0xe66fa - code32init_start)
LONG(0xe6708 - code32init_start)
LONG(0xe675a - code32init_start)
LONG(0xe67a1 - code32init_start)
LONG(0xe67ea - code32init_start)
LONG(0xe68e2 - code32init_start)
LONG(0xe694e - code32init_start)
LONG(0xe69ab - code32init_start)
LONG(0xe6a67 - code32init_start)
LONG(0xe6aa9 - code32init_start)
LONG(0xe6b47 - code32init_start)
LONG(0xe6b73 - code32init_start)
LONG(0xe6bf4 - code32init_start)
LONG(0xe6c10 - code32init_start)
LONG(0xe6cbd - code32init_start)
LONG(0xe6cd6 - code32init_start)
LONG(0xe6d4a - code32init_start)
LONG(0xe6d67 - code32init_start)
LONG(0xe6e17 - code32init_start)
LONG(0xe6e2e - code32init_start)
LONG(0xe6e3c - code32init_start)
LONG(0xe6e7b - code32init_start)
LONG(0xe6ed5 - code32init_start)
LONG(0xe6ee6 - code32init_start)
LONG(0xe6f32 - code32init_start)
LONG(0xe6fc3 - code32init_start)
LONG(0xe6ffd - code32init_start)
LONG(0xe7076 - code32init_start)
LONG(0xe7101 - code32init_start)
LONG(0xe710e - code32init_start)
LONG(0xe7117 - code32init_start)
LONG(0xe7154 - code32init_start)
LONG(0xe7198 - code32init_start)
LONG(0xe71b4 - code32init_start)
LONG(0xe726c - code32init_start)
LONG(0xe72dc - code32init_start)
LONG(0xe7370 - code32init_start)
LONG(0xe7397 - code32init_start)
LONG(0xe73bc - code32init_start)
LONG(0xe7446 - code32init_start)
LONG(0xe748b - code32init_start)
LONG(0xe749c - code32init_start)
LONG(0xe7547 - code32init_start)
LONG(0xe7558 - code32init_start)
LONG(0xe75c8 - code32init_start)
LONG(0xe75e9 - code32init_start)
LONG(0xe76c4 - code32init_start)
LONG(0xe7708 - code32init_start)
LONG(0xe771b - code32init_start)
LONG(0xe7724 - code32init_start)
LONG(0xe77f8 - code32init_start)
LONG(0xe7806 - code32init_start)
LONG(0xe7894 - code32init_start)
LONG(0xe78c4 - code32init_start)
LONG(0xe78e1 - code32init_start)
LONG(0xe7925 - code32init_start)
LONG(0xe793a - code32init_start)
LONG(0xe7994 - code32init_start)
LONG(0xe79aa - code32init_start)
LONG(0xe79e4 - code32init_start)
LONG(0xe79ff - code32init_start)
LONG(0xe7a17 - code32init_start)
LONG(0xe7a71 - code32init_start)
LONG(0xe7a8a - code32init_start)
LONG(0xe7ae0 - code32init_start)
LONG(0xe7af3 - code32init_start)
LONG(0xe7b09 - code32init_start)
LONG(0xe7b64 - code32init_start)
LONG(0xe7ba9 - code32init_start)
LONG(0xe7bbf - code32init_start)
LONG(0xe7bd1 - code32init_start)
LONG(0xe7bd6 - code32init_start)
LONG(0xe7be9 - code32init_start)
LONG(0xe7c46 - code32init_start)
LONG(0xe7c58 - code32init_start)
LONG(0xe7c8c - code32init_start)
LONG(0xe7c9f - code32init_start)
LONG(0xe7cc8 - code32init_start)
LONG(0xe7cdb - code32init_start)
LONG(0xe7cf2 - code32init_start)
LONG(0xe7d05 - code32init_start)
LONG(0xe7d2e - code32init_start)
LONG(0xe7d41 - code32init_start)
LONG(0xe7d93 - code32init_start)
LONG(0xe7dd0 - code32init_start)
LONG(0xe7e03 - code32init_start)
LONG(0xe7e2a - code32init_start)
LONG(0xe7e41 - code32init_start)
LONG(0xe7e90 - code32init_start)
LONG(0xe7ebe - code32init_start)
LONG(0xe7f40 - code32init_start)
LONG(0xe7f7c - code32init_start)
LONG(0xe7fa0 - code32init_start)
LONG(0xe7fe2 - code32init_start)
LONG(0xe802b - code32init_start)
LONG(0xe8074 - code32init_start)
LONG(0xe8115 - code32init_start)
LONG(0xe8127 - code32init_start)
LONG(0xe8141 - code32init_start)
LONG(0xe817f - code32init_start)
LONG(0xe81bb - code32init_start)
LONG(0xe8596 - code32init_start)
LONG(0xe85be - code32init_start)
LONG(0xe8625 - code32init_start)
LONG(0xe8676 - code32init_start)
LONG(0xe8689 - code32init_start)
LONG(0xe86a1 - code32init_start)
LONG(0xe86ea - code32init_start)
LONG(0xe8782 - code32init_start)
LONG(0xe8826 - code32init_start)
LONG(0xe883a - code32init_start)
LONG(0xe8868 - code32init_start)
LONG(0xe88f9 - code32init_start)
LONG(0xe8937 - code32init_start)
LONG(0xe8956 - code32init_start)
LONG(0xe8970 - code32init_start)
LONG(0xe89d3 - code32init_start)
LONG(0xe8a04 - code32init_start)
LONG(0xe8a1c - code32init_start)
LONG(0xe8a93 - code32init_start)
LONG(0xe8a9d - code32init_start)
LONG(0xe8aa7 - code32init_start)
LONG(0xe8b14 - code32init_start)
LONG(0xe8b91 - code32init_start)
LONG(0xe8bb7 - code32init_start)
LONG(0xe8bda - code32init_start)
LONG(0xe8c36 - code32init_start)
LONG(0xe8c49 - code32init_start)
LONG(0xe8c54 - code32init_start)
LONG(0xe8c67 - code32init_start)
LONG(0xe8c7a - code32init_start)
LONG(0xe8c8a - code32init_start)
LONG(0xe8ca4 - code32init_start)
LONG(0xe8cba - code32init_start)
LONG(0xe8cd4 - code32init_start)
LONG(0xe8ce9 - code32init_start)
LONG(0xe8cf4 - code32init_start)
LONG(0xe8d0a - code32init_start)
LONG(0xe8d25 - code32init_start)
LONG(0xe8d44 - code32init_start)
LONG(0xe8d66 - code32init_start)
LONG(0xe8d82 - code32init_start)
LONG(0xe8dbd - code32init_start)
LONG(0xe8e05 - code32init_start)
LONG(0xe8ee8 - code32init_start)
LONG(0xe8f0b - code32init_start)
LONG(0xe8f30 - code32init_start)
LONG(0xe8f43 - code32init_start)
LONG(0xe8f5e - code32init_start)
LONG(0xe8fb9 - code32init_start)
LONG(0xe9010 - code32init_start)
LONG(0xe9075 - code32init_start)
LONG(0xe90ca - code32init_start)
LONG(0xe9181 - code32init_start)
LONG(0xe919a - code32init_start)
LONG(0xe91a9 - code32init_start)
LONG(0xe91c2 - code32init_start)
LONG(0xe923a - code32init_start)
LONG(0xe9528 - code32init_start)
LONG(0xe95e4 - code32init_start)
LONG(0xe968b - code32init_start)
LONG(0xe969e - code32init_start)
LONG(0xe96ce - code32init_start)
LONG(0xe96e0 - code32init_start)
LONG(0xe9740 - code32init_start)
LONG(0xe9757 - code32init_start)
LONG(0xe9797 - code32init_start)
LONG(0xe97af - code32init_start)
LONG(0xe9804 - code32init_start)
LONG(0xe9826 - code32init_start)
LONG(0xe9831 - code32init_start)
LONG(0xe9836 - code32init_start)
LONG(0xe985f - code32init_start)
LONG(0xe9883 - code32init_start)
LONG(0xe989d - code32init_start)
LONG(0xe98bd - code32init_start)
LONG(0xe99c3 - code32init_start)
LONG(0xe9a15 - code32init_start)
LONG(0xe9a29 - code32init_start)
LONG(0xe9abf - code32init_start)
LONG(0xe9ad1 - code32init_start)
LONG(0xe9af0 - code32init_start)
LONG(0xe9b1b - code32init_start)
LONG(0xe9b2b - code32init_start)
LONG(0xe9b50 - code32init_start)
LONG(0xe9b5e - code32init_start)
LONG(0xe9b7d - code32init_start)
LONG(0xe9bc2 - code32init_start)
LONG(0xe9bcc - code32init_start)
LONG(0xe9be1 - code32init_start)
LONG(0xe9c89 - code32init_start)
LONG(0xe9d9f - code32init_start)
LONG(0xe9e31 - code32init_start)
        _reloc_rel_end = ABSOLUTE(.) ;
        _reloc_init_start = ABSOLUTE(.) ;
LONG(0xf1a55 - code32flat_start)
LONG(0xfc9e9 - code32flat_start)
LONG(0xfd0f0 - code32flat_start)
        _reloc_init_end = ABSOLUTE(.) ;

. = ( 0xd7260 - code32flat_start ) ;
*32flat.*(.data.varlow../src/tcgbios.c.1354)
. = ( 0xd7261 - code32flat_start ) ;
*32flat.*(.data.varlow../src/tcgbios.c.901)
. = ( 0xd7264 - code32flat_start ) ;
*32flat.*(.data.varlow../src/tcgbios.c.49)
. = ( 0xd7278 - code32flat_start ) ;
*32flat.*(.data.varlow../src/boot.c.992)
. = ( 0xd727c - code32flat_start ) ;
*32flat.*(.data.varlow../src/hw/mpt-scsi.c.48)
. = ( 0xd7280 - code32flat_start ) ;
*32flat.*(.data.varlow../src/hw/floppy.c.194)
. = ( 0xd7284 - code32flat_start ) ;
*32flat.*(.data.varlow../src/hw/usb-hid.c.253)
. = ( 0xd728c - code32flat_start ) ;
*32flat.*(.data.varlow../src/hw/ps2port.c.211)
. = ( 0xd7290 - code32flat_start ) ;
*32flat.*(.data.varlow../src/hw/rtc.c.74)
. = ( 0xd7294 - code32flat_start ) ;
*32flat.*(.data.varlow../src/hw/timer.c.155)
. = ( 0xd7298 - code32flat_start ) ;
*32flat.*(.data.varlow../src/clock.c.30)
. = ( 0xd7299 - code32flat_start ) ;
*32flat.*(.data.varlow../src/sercon.c.552)
. = ( 0xd729c - code32flat_start ) ;
*32flat.*(.data.varlow../src/sercon.c.551)
. = ( 0xd72ac - code32flat_start ) ;
*32flat.*(.data.varlow../src/sercon.c.68)
. = ( 0xd72ad - code32flat_start ) ;
*32flat.*(.data.varlow../src/sercon.c.67)
. = ( 0xd72ae - code32flat_start ) ;
*32flat.*(.data.varlow../src/sercon.c.66)
. = ( 0xd72af - code32flat_start ) ;
*32flat.*(.data.varlow../src/sercon.c.65)
. = ( 0xd72b0 - code32flat_start ) ;
*32flat.*(.data.varlow../src/sercon.c.64)
. = ( 0xd72b1 - code32flat_start ) ;
*32flat.*(.data.varlow../src/sercon.c.51)
. = ( 0xd72b2 - code32flat_start ) ;
*32flat.*(.data.varlow../src/sercon.c.50)
. = ( 0xd72b4 - code32flat_start ) ;
*32flat.*(.data.varlow../src/sercon.c.49)
. = ( 0xd72b8 - code32flat_start ) ;
*32flat.*(.data.varlow../src/disk.c.439)
. = ( 0xd72c8 - code32flat_start ) ;
*32flat.*(.data.varlow../src/cdrom.c.26)
. = ( 0xd72cc - code32flat_start ) ;
*32flat.*(.data.varlow../src/cdrom.c.25)
. = ( 0xd72e0 - code32flat_start ) ;
*32flat.*(.data.varlow../src/block.c.418)
. = ( 0xd72f0 - code32flat_start ) ;
*32flat.*(.data.varlow../src/stacks.c.327)
. = ( 0xd72f8 - code32flat_start ) ;
*32flat.*(.data.varlow../src/stacks.c.326)
. = ( 0xd7afc - code32flat_start ) ;
*32flat.*(.data.varlow../src/stacks.c.33)
. = ( 0xd7b20 - code32flat_start ) ;
*32flat.*(.text.hlist_del)
. = ( 0xd7b2f - code32flat_start ) ;
*32flat.*(.text.hlist_add)
. = ( 0xd7b40 - code32flat_start ) ;
*32flat.*(.text.putc_str)
. = ( 0xd7b4e - code32flat_start ) ;
*32flat.*(.text.memcmp)
. = ( 0xd7b6e - code32flat_start ) ;
*32flat.*(.text.strtcpy)
. = ( 0xd7b8f - code32flat_start ) ;
*32flat.*(.text.nullTrailingSpace)
. = ( 0xd7bbb - code32flat_start ) ;
*32flat.*(.text.pci_find_capability)
. = ( 0xd7c38 - code32flat_start ) ;
*32flat.*(.text.usb_add_freelist)
. = ( 0xd7c45 - code32flat_start ) ;
*32flat.*(.text.usb_get_freelist)
. = ( 0xd7c64 - code32flat_start ) ;
*32flat.*(.text.usb_desc2pipe)
. = ( 0xd7c9a - code32flat_start ) ;
*32flat.*(.text.usb_find_desc)
. = ( 0xd7cd9 - code32flat_start ) ;
*32flat.*(.text.uhci_hub_disconnect)
. = ( 0xd7ce8 - code32flat_start ) ;
*32flat.*(.text.ohci_hub_detect)
. = ( 0xd7cf9 - code32flat_start ) ;
*32flat.*(.text.ohci_hub_disconnect)
. = ( 0xd7d0b - code32flat_start ) ;
*32flat.*(.text.ohci_desc2pipe)
. = ( 0xd7d54 - code32flat_start ) ;
*32flat.*(.text.ehci_hub_disconnect)
. = ( 0xd7d67 - code32flat_start ) ;
*32flat.*(.text.ehci_desc2pipe)
. = ( 0xd7e0a - code32flat_start ) ;
*32flat.*(.text.ata_extract_version)
. = ( 0xd7e24 - code32flat_start ) ;
*32flat.*(.text.found_compatibleahci)
. = ( 0xd7e25 - code32flat_start ) ;
*32flat.*(.text.alloc_new)
. = ( 0xd7e71 - code32flat_start ) ;
*32flat.*(.text.alloc_free)
. = ( 0xd7e8a - code32flat_start ) ;
*32flat.*(.text.alloc_find)
. = ( 0xd7ea9 - code32flat_start ) ;
*32flat.*(.text.malloc_pfree)
. = ( 0xd7ede - code32flat_start ) ;
*32flat.*(.text.malloc_getspace)
. = ( 0xd7f37 - code32flat_start ) ;
*32flat.*(.text.rom_reserve)
. = ( 0xd7f73 - code32flat_start ) ;
*32flat.*(.text.calcRamSize)
. = ( 0xd7fc0 - code32flat_start ) ;
*32flat.*(.text.romfile_findprefix)
. = ( 0xd7ff8 - code32flat_start ) ;
*32flat.*(.text.glob_prefix)
. = ( 0xd8032 - code32flat_start ) ;
*32flat.*(.text.parse_u32)
. = ( 0xd8061 - code32flat_start ) ;
*32flat.*(.text.usb_portmap)
. = ( 0xd807a - code32flat_start ) ;
*32flat.*(.text.add_bev)
. = ( 0xd80cf - code32flat_start ) ;
*32flat.*(.text.unlikely.idctqtab)
. = ( 0xd8125 - code32flat_start ) ;
*32flat.*(.text.tpm_set_log_area)
. = ( 0xd816b - code32flat_start ) ;
*32flat.*(.text.unlikely.tpm20_get_suppt_pcrbanks)
. = ( 0xd821a - code32flat_start ) ;
*32flat.*(.text.pci_find_device)
. = ( 0xd8242 - code32flat_start ) ;
*32flat.*(.text.pci_init_device)
. = ( 0xd8299 - code32flat_start ) ;
*32flat.*(.text.xhci_hub_detect)
. = ( 0xd82a8 - code32flat_start ) ;
*32flat.*(.text.xhci_hub_portmap)
. = ( 0xd82e5 - code32flat_start ) ;
*32flat.*(.text.xhci_hub_disconnect)
. = ( 0xd82e6 - code32flat_start ) ;
*32flat.*(.text.smbios_next)
. = ( 0xd8342 - code32flat_start ) ;
*32flat.*(.text.piix_pci_slot_get_irq)
. = ( 0xd836e - code32flat_start ) ;
*32flat.*(.text.mch_pci_slot_get_irq)
. = ( 0xd83a8 - code32flat_start ) ;
*32flat.*(.text.piix_ide_setup)
. = ( 0xd83cf - code32flat_start ) ;
*32flat.*(.text.ich9_smbus_setup)
. = ( 0xd83dc - code32flat_start ) ;
*32flat.*(.text.i440fx_mem_addr_setup)
. = ( 0xd841a - code32flat_start ) ;
*32flat.*(.text.pci_region_align)
. = ( 0xd8437 - code32flat_start ) ;
*32flat.*(.text.pci_region_sum)
. = ( 0xd845b - code32flat_start ) ;
*32flat.*(.text.pci_region_migrate_64bit_entries)
. = ( 0xd849f - code32flat_start ) ;
*32flat.*(.text.pci_bios_init_root_regions_mem)
. = ( 0xd858c - code32flat_start ) ;
*32flat.*(.text.apic_id_is_present)
. = ( 0xd85a8 - code32flat_start ) ;
*32flat.*(.text.piix4_fadt_setup)
. = ( 0xd85f4 - code32flat_start ) ;
*32flat.*(.text.ich9_lpc_fadt_setup)
. = ( 0xd863f - code32flat_start ) ;
*32flat.*(.text.getHex)
. = ( 0xd864f - code32flat_start ) ;
*32flat.*(.text.vp_get_features)
. = ( 0xd86c7 - code32flat_start ) ;
*32flat.*(.text.memmove)
. = ( 0xd86ee - code32flat_start ) ;
*32flat.*(.text.remove_e820)
. = ( 0xd871b - code32flat_start ) ;
*32flat.*(.text.const_read_file)
. = ( 0xd8743 - code32flat_start ) ;
*32flat.*(.text.usb_get_period.isra.19)
. = ( 0xd8763 - code32flat_start ) ;
*32flat.*(.text.is_pci_vga)
. = ( 0xd87aa - code32flat_start ) ;
*32flat.*(.text.getword.isra.27)
. = ( 0xd87c5 - code32flat_start ) ;
*32flat.*(.text.readtables)
. = ( 0xd8b47 - code32flat_start ) ;
*32flat.*(.text.fillbits)
. = ( 0xd8bc3 - code32flat_start ) ;
*32flat.*(.text.dec_rec2)
. = ( 0xd8cd2 - code32flat_start ) ;
*32flat.*(.text.idct)
. = ( 0xd8fdf - code32flat_start ) ;
*32flat.*(.text.tpm_can_show_menu)
. = ( 0xd9011 - code32flat_start ) ;
*32flat.*(.text.romfile_loader_find)
. = ( 0xd904e - code32flat_start ) ;
*32flat.*(.text.vp_set_features)
. = ( 0xd90d0 - code32flat_start ) ;
*32flat.*(.text.vp_get_status)
. = ( 0xd90f5 - code32flat_start ) ;
*32flat.*(.text.vp_set_status)
. = ( 0xd9127 - code32flat_start ) ;
*32flat.*(.text.vp_reset)
. = ( 0xd917d - code32flat_start ) ;
*32flat.*(.text.ata_extract_model.constprop.157)
. = ( 0xd91a2 - code32flat_start ) ;
*32flat.*(.text.detect_serial.constprop.170)
. = ( 0xd91e6 - code32flat_start ) ;
*32flat.*(.text.pci_config_maskw.constprop.183)
. = ( 0xd920c - code32flat_start ) ;
*32flat.*(.text.pic_irqmask_mask.constprop.196)
. = ( 0xd9225 - code32flat_start ) ;
*32flat.*(.text.get_acpi_rsdp_length)
. = ( 0xd9288 - code32flat_start ) ;
*32flat.*(.text.build_header.constprop.151)
. = ( 0xd92cc - code32flat_start ) ;
*32flat.*(.text.tpm12_get_capability)
. = ( 0xd9340 - code32flat_start ) ;
*32flat.*(.text.tpm12_read_has_owner)
. = ( 0xd9371 - code32flat_start ) ;
*32flat.*(.text.tpm12_read_permanent_flags.constprop.192)
. = ( 0xd93b8 - code32flat_start ) ;
*32flat.*(.text.tpm12_enable_tpm.isra.118)
. = ( 0xd9404 - code32flat_start ) ;
*32flat.*(.text.tpm20_write_EfiSpecIdEventStruct)
. = ( 0xd9533 - code32flat_start ) ;
*32flat.*(.text.uhci_hub_reset)
. = ( 0xd956e - code32flat_start ) ;
*32flat.*(.text.romfile_find)
. = ( 0xd959f - code32flat_start ) ;
*32flat.*(.text.romfile_loadint)
. = ( 0xd95fe - code32flat_start ) ;
*32flat.*(.text.build_notify)
. = ( 0xd96a2 - code32flat_start ) ;
*32flat.*(.text.apple_macio_setup)
. = ( 0xd96b4 - code32flat_start ) ;
*32flat.*(.text.storage_ide_setup)
. = ( 0xd9700 - code32flat_start ) ;
*32flat.*(.text.pic_ibm_setup)
. = ( 0xd9712 - code32flat_start ) ;
*32flat.*(.text.wait_threads)
. = ( 0xd9726 - code32flat_start ) ;
*32flat.*(.text.mutex_lock)
. = ( 0xd973d - code32flat_start ) ;
*32flat.*(.text.call16_int10)
. = ( 0xd977b - code32flat_start ) ;
*32flat.*(.text.wait_preempt)
. = ( 0xd97a7 - code32flat_start ) ;
*32flat.*(.text.pci_enable_busmaster)
. = ( 0xd97ca - code32flat_start ) ;
*32flat.*(.text.iomemcpy)
. = ( 0xd980e - code32flat_start ) ;
*32flat.*(.text.qemu_cfg_read_file)
. = ( 0xd986c - code32flat_start ) ;
*32flat.*(.text.msleep)
. = ( 0xd9888 - code32flat_start ) ;
*32flat.*(.text.uhci_hub_detect)
. = ( 0xd98b2 - code32flat_start ) ;
*32flat.*(.text.ehci_hub_reset)
. = ( 0xd98ec - code32flat_start ) ;
*32flat.*(.text.ehci_hub_detect)
. = ( 0xd9934 - code32flat_start ) ;
*32flat.*(.text.get_keystroke_full)
. = ( 0xd99d8 - code32flat_start ) ;
*32flat.*(.text.get_keystroke)
. = ( 0xd99e5 - code32flat_start ) ;
*32flat.*(.text.free)
. = ( 0xd9a02 - code32flat_start ) ;
*32flat.*(.text.pci_enable_iobar)
. = ( 0xd9a6b - code32flat_start ) ;
*32flat.*(.text.__end_thread)
. = ( 0xd9a94 - code32flat_start ) ;
*32flat.*(.text.add_drive)
. = ( 0xd9ab4 - code32flat_start ) ;
*32flat.*(.text.deploy_romfile)
. = ( 0xd9af5 - code32flat_start ) ;
*32flat.*(.text.wrmsr_smp)
. = ( 0xd9b3c - code32flat_start ) ;
*32flat.*(.text.insert_e820)
. = ( 0xd9bd4 - code32flat_start ) ;
*32flat.*(.text.e820_add.part.86)
. = ( 0xd9daf - code32flat_start ) ;
*32flat.*(.text.e820_add)
. = ( 0xd9dbf - code32flat_start ) ;
*32flat.*(.text.alloc_new_detail)
. = ( 0xd9e49 - code32flat_start ) ;
*32flat.*(.text.malloc_palloc.part.88)
. = ( 0xd9e83 - code32flat_start ) ;
*32flat.*(.text.malloc_palloc)
. = ( 0xd9e8f - code32flat_start ) ;
*32flat.*(.text.malloc_tmphigh)
. = ( 0xd9ea0 - code32flat_start ) ;
*32flat.*(.text.malloc_low)
. = ( 0xd9eb1 - code32flat_start ) ;
*32flat.*(.text.malloc_fseg)
. = ( 0xd9ec2 - code32flat_start ) ;
*32flat.*(.text.memalign_high)
. = ( 0xd9ece - code32flat_start ) ;
*32flat.*(.text.malloc_high)
. = ( 0xd9edf - code32flat_start ) ;
*32flat.*(.text.zalloc_page_aligned)
. = ( 0xd9f01 - code32flat_start ) ;
*32flat.*(.text.memalign_tmp)
. = ( 0xd9f2a - code32flat_start ) ;
*32flat.*(.text.malloc_tmp)
. = ( 0xd9f4a - code32flat_start ) ;
*32flat.*(.text.run_thread)
. = ( 0xd9fd3 - code32flat_start ) ;
*32flat.*(.text.alloc_add)
. = ( 0xda026 - code32flat_start ) ;
*32flat.*(.text.xhci_alloc_inctx)
. = ( 0xda106 - code32flat_start ) ;
*32flat.*(.text.usb_enumerate)
. = ( 0xda178 - code32flat_start ) ;
*32flat.*(.text.romfile_loadfile)
. = ( 0xda1e3 - code32flat_start ) ;
*32flat.*(.text.bootentry_add)
. = ( 0xda27f - code32flat_start ) ;
*32flat.*(.text.boot_add_hd)
. = ( 0xda29e - code32flat_start ) ;
*32flat.*(.text.qemu_romfile_add)
. = ( 0xda31d - code32flat_start ) ;
*32flat.*(.text.pci_region_create_entry)
. = ( 0xda3f4 - code32flat_start ) ;
*32flat.*(.text.create_bounce_buf)
. = ( 0xda42b - code32flat_start ) ;
*32flat.*(.text.init_atadrive)
. = ( 0xda489 - code32flat_start ) ;
*32flat.*(.text.nvme_init_cq)
. = ( 0xda4fb - code32flat_start ) ;
*32flat.*(.text.nvme_init_sq)
. = ( 0xda571 - code32flat_start ) ;
*32flat.*(.text.pvscsi_init_rings.constprop.135)
. = ( 0xda69e - code32flat_start ) ;
*32flat.*(.text.__i8042_command)
. = ( 0xda71c - code32flat_start ) ;
*32flat.*(.text.i8042_flush)
. = ( 0xda74f - code32flat_start ) ;
*32flat.*(.text.configure_uhci)
. = ( 0xda90f - code32flat_start ) ;
*32flat.*(.text.ohci_hub_reset)
. = ( 0xda995 - code32flat_start ) ;
*32flat.*(.text.configure_ohci)
. = ( 0xdabf5 - code32flat_start ) ;
*32flat.*(.text.send_ata_identity)
. = ( 0xdaca3 - code32flat_start ) ;
*32flat.*(.text.powerup_await_non_bsy)
. = ( 0xdacee - code32flat_start ) ;
*32flat.*(.text.ahci_port_reset)
. = ( 0xdad83 - code32flat_start ) ;
*32flat.*(.text.ahci_port_release)
. = ( 0xdadb1 - code32flat_start ) ;
*32flat.*(.text.wait_bit)
. = ( 0xdadfb - code32flat_start ) ;
*32flat.*(.text.nvme_admin_identify)
. = ( 0xdae8b - code32flat_start ) ;
*32flat.*(.text.nvme_wait_csts_rdy)
. = ( 0xdaef7 - code32flat_start ) ;
*32flat.*(.text.configure_ehci)
. = ( 0xdb12e - code32flat_start ) ;
*32flat.*(.text.tsctimer_setfreq.part.75)
. = ( 0xdb18f - code32flat_start ) ;
*32flat.*(.text.pmtimer_setup)
. = ( 0xdb1c0 - code32flat_start ) ;
*32flat.*(.text.piix4_pm_setup)
. = ( 0xdb1ea - code32flat_start ) ;
*32flat.*(.text.map_pcirom)
. = ( 0xdb32c - code32flat_start ) ;
*32flat.*(.text.boot_lchs_find)
. = ( 0xdb375 - code32flat_start ) ;
*32flat.*(.text.find_prio)
. = ( 0xdb3b6 - code32flat_start ) ;
*32flat.*(.text.is_bootprio_strict)
. = ( 0xdb3d9 - code32flat_start ) ;
*32flat.*(.text.pci_enable_membar)
. = ( 0xdb463 - code32flat_start ) ;
*32flat.*(.text.sdcard_set_frequency)
. = ( 0xdb4f6 - code32flat_start ) ;
*32flat.*(.text.pci_find_resource_reserve_capability)
. = ( 0xdb589 - code32flat_start ) ;
*32flat.*(.text.pci_bios_init_bus_rec)
. = ( 0xdb7cc - code32flat_start ) ;
*32flat.*(.text.dummy_pci_slot_get_irq)
. = ( 0xdb7dd - code32flat_start ) ;
*32flat.*(.text.pci_region_map_entries)
. = ( 0xdba0c - code32flat_start ) ;
*32flat.*(.text.piix_isa_bridge_setup)
. = ( 0xdba7b - code32flat_start ) ;
*32flat.*(.text.fill_dsdt)
. = ( 0xdbaaf - code32flat_start ) ;
*32flat.*(.text.vp_init_simple)
. = ( 0xdbd26 - code32flat_start ) ;
*32flat.*(.text.mch_isa_bridge_setup)
. = ( 0xdbddb - code32flat_start ) ;
*32flat.*(.text.pci_probe_devices)
. = ( 0xdbf8b - code32flat_start ) ;
*32flat.*(.text.init_floppy)
. = ( 0xdc012 - code32flat_start ) ;
*32flat.*(.text.configure_xhci)
. = ( 0xdc314 - code32flat_start ) ;
*32flat.*(.text.intel_igd_setup)
. = ( 0xdc433 - code32flat_start ) ;
*32flat.*(.text.vp_find_vq)
. = ( 0xdc70a - code32flat_start ) ;
*32flat.*(.text.sdcard_pio_app.constprop.166)
. = ( 0xdc746 - code32flat_start ) ;
*32flat.*(.text.copy_pir)
. = ( 0xdc7b2 - code32flat_start ) ;
*32flat.*(.text.copy_mptable.part.104)
. = ( 0xdc866 - code32flat_start ) ;
*32flat.*(.text.copy_acpi_rsdp)
. = ( 0xdc8c2 - code32flat_start ) ;
*32flat.*(.text.copy_smbios)
. = ( 0xdc955 - code32flat_start ) ;
*32flat.*(.text.xhci_print_port_state.constprop.162)
. = ( 0xdc9b1 - code32flat_start ) ;
*32flat.*(.text.xhci_hub_reset)
. = ( 0xdca4a - code32flat_start ) ;
*32flat.*(.text.mch_mem_addr_setup)
. = ( 0xdcab6 - code32flat_start ) ;
*32flat.*(.text.init_controller.constprop.182)
. = ( 0xdcb53 - code32flat_start ) ;
*32flat.*(.text.found_genericata)
. = ( 0xdcc13 - code32flat_start ) ;
*32flat.*(.text.unlikely.ps2_recvbyte.constprop.187)
. = ( 0xdcc97 - code32flat_start ) ;
*32flat.*(.text.unlikely.ps2_sendbyte.constprop.164)
. = ( 0xdcccc - code32flat_start ) ;
*32flat.*(.text.unlikely.ps2_kbd_command)
. = ( 0xdcdf9 - code32flat_start ) ;
*32flat.*(.text.ps2_keyboard_setup)
. = ( 0xdcf70 - code32flat_start ) ;
*32flat.*(.text.enable_vga_console)
. = ( 0xdd0ff - code32flat_start ) ;
*32flat.*(.text.tpm12_activate_tpm.constprop.191)
. = ( 0xdd174 - code32flat_start ) ;
*32flat.*(.text.tpm12_set_owner_install.constprop.144)
. = ( 0xdd201 - code32flat_start ) ;
*32flat.*(.text.snprintf)
. = ( 0xdd24c - code32flat_start ) ;
*32flat.*(.text.bootprio_find_named_rom)
. = ( 0xdd29d - code32flat_start ) ;
*32flat.*(.text.build_usb_path.isra.84)
. = ( 0xdd2e1 - code32flat_start ) ;
*32flat.*(.text.get_field)
. = ( 0xdd32c - code32flat_start ) ;
*32flat.*(.text.get_external)
. = ( 0xdd467 - code32flat_start ) ;
*32flat.*(.text.smbios_init_type_4)
. = ( 0xdd68a - code32flat_start ) ;
*32flat.*(.text.smbios_init_type_17)
. = ( 0xdd7de - code32flat_start ) ;
*32flat.*(.text.interface_init)
. = ( 0xde328 - code32flat_start ) ;
*32flat.*(.text.build_pci_path.constprop.184)
. = ( 0xde3d8 - code32flat_start ) ;
*32flat.*(.text.boot_lchs_find_ata_device)
. = ( 0xde44a - code32flat_start ) ;
*32flat.*(.text.boot_lchs_find_scsi_device)
. = ( 0xde4bc - code32flat_start ) ;
*32flat.*(.text.bootprio_find_usb)
. = ( 0xde54c - code32flat_start ) ;
*32flat.*(.text.getRomPriority)
. = ( 0xde5bc - code32flat_start ) ;
*32flat.*(.text.bootprio_find_pci_device)
. = ( 0xde5de - code32flat_start ) ;
*32flat.*(.text.znprintf)
. = ( 0xde63f - code32flat_start ) ;
*32flat.*(.text.init_virtio_blk)
. = ( 0xde8ab - code32flat_start ) ;
*32flat.*(.text.sdcard_controller_setup.part.102)
. = ( 0xded29 - code32flat_start ) ;
*32flat.*(.text.sdcard_pci_setup)
. = ( 0xded5b - code32flat_start ) ;
*32flat.*(.text.sdcard_romfile_setup)
. = ( 0xdeda3 - code32flat_start ) ;
*32flat.*(.text.init_optionrom)
. = ( 0xdeebc - code32flat_start ) ;
*32flat.*(.text.run_file_roms)
. = ( 0xdef08 - code32flat_start ) ;
*32flat.*(.text.jpeg_show)
. = ( 0xdfc69 - code32flat_start ) ;
*32flat.*(.text.bootprio_find_scsi_device)
. = ( 0xdfcb4 - code32flat_start ) ;
*32flat.*(.text.bootprio_find_ata_device)
. = ( 0xdfcff - code32flat_start ) ;
*32flat.*(.text.usb_send_default_control)
. = ( 0xdfd1d - code32flat_start ) ;
*32flat.*(.text.get_port_status)
. = ( 0xdfd61 - code32flat_start ) ;
*32flat.*(.text.usb_hub_detect)
. = ( 0xdfd8b - code32flat_start ) ;
*32flat.*(.text.set_port_feature)
. = ( 0xdfdcc - code32flat_start ) ;
*32flat.*(.text.usb_hub_disconnect)
. = ( 0xdfe20 - code32flat_start ) ;
*32flat.*(.text.usb_hub_reset)
. = ( 0xdfecb - code32flat_start ) ;
*32flat.*(.text.xhci_cmd_submit)
. = ( 0xdff50 - code32flat_start ) ;
*32flat.*(.text.usb_realloc_pipe)
. = ( 0xe0b2c - code32flat_start ) ;
*32flat.*(.text.usb_alloc_pipe)
. = ( 0xe0b35 - code32flat_start ) ;
*32flat.*(.text.usb_free_pipe)
. = ( 0xe0b41 - code32flat_start ) ;
*32flat.*(.text.addFloppy)
. = ( 0xe0be7 - code32flat_start ) ;
*32flat.*(.text.device_hardware_setup)
. = ( 0xe17f5 - code32flat_start ) ;
*32flat.*(.text.acpi_setup)
. = ( 0xe2348 - code32flat_start ) ;
*32flat.*(.text.init_pcirom)
. = ( 0xe247f - code32flat_start ) ;
*32flat.*(.text.optionrom_setup)
. = ( 0xe26b1 - code32flat_start ) ;
*32flat.*(.text.qemu_platform_setup)
. = ( 0xe4d61 - code32flat_start ) ;
*32flat.*(.text.nvme_controller_setup)
. = ( 0xe5180 - code32flat_start ) ;
*32flat.*(.text.ahci_port_setup)
. = ( 0xe55e2 - code32flat_start ) ;
*32flat.*(.text.init../src/stacks.c.732)
. = ( 0xe55f2 - code32flat_start ) ;
*32flat.*(.text.cdrom_media_info)
. = ( 0xe56b5 - code32flat_start ) ;
*32flat.*(.text.boot_add_cd)
. = ( 0xe570c - code32flat_start ) ;
*32flat.*(.text.ata_detect)
. = ( 0xe5b0b - code32flat_start ) ;
*32flat.*(.text.ahci_port_detect)
. = ( 0xe5c79 - code32flat_start ) ;
*32flat.*(.text.scsi_rep_luns_scan)
. = ( 0xe5da6 - code32flat_start ) ;
*32flat.*(.text.init_esp_scsi)
. = ( 0xe5e22 - code32flat_start ) ;
*32flat.*(.text.init_virtio_scsi)
. = ( 0xe5f75 - code32flat_start ) ;
*32flat.*(.text.scsi_drive_setup)
. = ( 0xe6280 - code32flat_start ) ;
*32flat.*(.text.usb_hub_port_setup)
. = ( 0xe6b23 - code32flat_start ) ;
*32flat.*(.text.uas_add_lun)
. = ( 0xe6bd1 - code32flat_start ) ;
*32flat.*(.text.lsi_scsi_add_lun)
. = ( 0xe6c94 - code32flat_start ) ;
*32flat.*(.text.init_lsi_scsi)
. = ( 0xe6d27 - code32flat_start ) ;
*32flat.*(.text.esp_scsi_add_lun)
. = ( 0xe6de9 - code32flat_start ) ;
*32flat.*(.text.megasas_scan_target)
. = ( 0xe6fb1 - code32flat_start ) ;
*32flat.*(.text.init_megasas)
. = ( 0xe7175 - code32flat_start ) ;
*32flat.*(.text.mpt_scsi_add_lun)
. = ( 0xe7238 - code32flat_start ) ;
*32flat.*(.text.init_mpt_scsi)
. = ( 0xe7330 - code32flat_start ) ;
*32flat.*(.text.virtio_scsi_add_lun)
. = ( 0xe741a - code32flat_start ) ;
*32flat.*(.text.init_pvscsi)
. = ( 0xe7527 - code32flat_start ) ;
*32flat.*(.text.maininit)
. = ( 0xe9a21 - code32flat_start ) ;
*32flat.*(.text.init../src/post.c.303)
. = ( 0xe9e1e - code32flat_start ) ;
*32flat.*(.text.init../src/pmm.c.133)
. = ( 0xe9ff0 - code32flat_start ) ;
*32flat.*(.rodata.vp_init_simple)
. = ( 0xea004 - code32flat_start ) ;
*32flat.*(.rodata.maininit)
. = ( 0xea028 - code32flat_start ) ;
*32flat.*(.rodata.CSWTCH.1949)
. = ( 0xea03c - code32flat_start ) ;
*32flat.*(.rodata.__func__.16507)
. = ( 0xea04c - code32flat_start ) ;
*32flat.*(.rodata.__func__.16487)
. = ( 0xea060 - code32flat_start ) ;
*32flat.*(.rodata.__func__.16564)
. = ( 0xea074 - code32flat_start ) ;
*32flat.*(.rodata.__func__.16436)
. = ( 0xea084 - code32flat_start ) ;
*32flat.*(.rodata.__func__.16443)
. = ( 0xea094 - code32flat_start ) ;
*32flat.*(.rodata.__func__.16575)
. = ( 0xea0ac - code32flat_start ) ;
*32flat.*(.rodata.__func__.16590)
. = ( 0xea0c4 - code32flat_start ) ;
*32flat.*(.rodata.__func__.16052)
. = ( 0xea0d8 - code32flat_start ) ;
*32flat.*(.rodata.__func__.16069)
. = ( 0xea0ec - code32flat_start ) ;
*32flat.*(.rodata.__func__.15982)
. = ( 0xea0fc - code32flat_start ) ;
*32flat.*(.rodata.__func__.15920)
. = ( 0xea108 - code32flat_start ) ;
*32flat.*(.rodata.__func__.15579)
. = ( 0xea128 - code32flat_start ) ;
*32flat.*(.rodata.__func__.15567)
. = ( 0xea144 - code32flat_start ) ;
*32flat.*(.rodata.__func__.15556)
. = ( 0xea160 - code32flat_start ) ;
*32flat.*(.rodata.__func__.15545)
. = ( 0xea178 - code32flat_start ) ;
*32flat.*(.rodata.__func__.15589)
. = ( 0xea190 - code32flat_start ) ;
*32flat.*(.rodata.__func__.15369)
. = ( 0xea1ac - code32flat_start ) ;
*32flat.*(.rodata.__func__.15390)
. = ( 0xea1bc - code32flat_start ) ;
*32flat.*(.rodata.__func__.15471)
. = ( 0xea1d0 - code32flat_start ) ;
*32flat.*(.rodata.__func__.15311)
. = ( 0xea1e0 - code32flat_start ) ;
*32flat.*(.rodata.__func__.15287)
. = ( 0xea1f0 - code32flat_start ) ;
*32flat.*(.rodata.__func__.15264)
. = ( 0xea1fc - code32flat_start ) ;
*32flat.*(.rodata.__func__.15244)
. = ( 0xea208 - code32flat_start ) ;
*32flat.*(.rodata.__func__.15145)
. = ( 0xea214 - code32flat_start ) ;
*32flat.*(.rodata.__func__.15212)
. = ( 0xea220 - code32flat_start ) ;
*32flat.*(.rodata.__func__.15219)
. = ( 0xea22c - code32flat_start ) ;
*32flat.*(.rodata.__func__.15139)
. = ( 0xea238 - code32flat_start ) ;
*32flat.*(.rodata.__func__.15299)
. = ( 0xea244 - code32flat_start ) ;
*32flat.*(.rodata.__func__.14959)
. = ( 0xea250 - code32flat_start ) ;
*32flat.*(.rodata.__func__.14520)
. = ( 0xea260 - code32flat_start ) ;
*32flat.*(.rodata.__func__.14716)
. = ( 0xea278 - code32flat_start ) ;
*32flat.*(.rodata.__func__.14607)
. = ( 0xea290 - code32flat_start ) ;
*32flat.*(.rodata.__func__.14851)
. = ( 0xea29c - code32flat_start ) ;
*32flat.*(.rodata.__func__.14236)
. = ( 0xea2b0 - code32flat_start ) ;
*32flat.*(.rodata.__func__.14241)
. = ( 0xea2c8 - code32flat_start ) ;
*32flat.*(.rodata.__func__.14228)
. = ( 0xea2dc - code32flat_start ) ;
*32flat.*(.rodata.__func__.14163)
. = ( 0xea2f0 - code32flat_start ) ;
*32flat.*(.rodata.__func__.14099)
. = ( 0xea308 - code32flat_start ) ;
*32flat.*(.rodata.__func__.14065)
. = ( 0xea314 - code32flat_start ) ;
*32flat.*(.rodata.__func__.13993)
. = ( 0xea324 - code32flat_start ) ;
*32flat.*(.rodata.__func__.13980)
. = ( 0xea334 - code32flat_start ) ;
*32flat.*(.rodata.__func__.13972)
. = ( 0xea340 - code32flat_start ) ;
*32flat.*(.rodata.__func__.13080)
. = ( 0xea354 - code32flat_start ) ;
*32flat.*(.rodata.__func__.13098)
. = ( 0xea36c - code32flat_start ) ;
*32flat.*(.rodata.__func__.12916)
. = ( 0xea37c - code32flat_start ) ;
*32flat.*(.rodata.__func__.12752)
. = ( 0xea390 - code32flat_start ) ;
*32flat.*(.rodata.__func__.12713)
. = ( 0xea3a0 - code32flat_start ) ;
*32flat.*(.rodata.__func__.12776)
. = ( 0xea3b0 - code32flat_start ) ;
*32flat.*(.rodata.__func__.12787)
. = ( 0xea3c0 - code32flat_start ) ;
*32flat.*(.rodata.__func__.12813)
. = ( 0xea3d4 - code32flat_start ) ;
*32flat.*(.rodata.__func__.12534)
. = ( 0xea3e0 - code32flat_start ) ;
*32flat.*(.rodata.__func__.12565)
. = ( 0xea3f0 - code32flat_start ) ;
*32flat.*(.rodata.__func__.12596)
. = ( 0xea400 - code32flat_start ) ;
*32flat.*(.rodata.__func__.12611)
. = ( 0xea418 - code32flat_start ) ;
*32flat.*(.rodata.__func__.12370)
. = ( 0xea428 - code32flat_start ) ;
*32flat.*(.rodata.__func__.12342)
. = ( 0xea43c - code32flat_start ) ;
*32flat.*(.rodata.__func__.12162)
. = ( 0xea44c - code32flat_start ) ;
*32flat.*(.rodata.__func__.12171)
. = ( 0xea460 - code32flat_start ) ;
*32flat.*(.rodata.__func__.12188)
. = ( 0xea470 - code32flat_start ) ;
*32flat.*(.rodata.__func__.12155)
. = ( 0xea480 - code32flat_start ) ;
*32flat.*(.rodata.__func__.12220)
. = ( 0xea498 - code32flat_start ) ;
*32flat.*(.rodata.__func__.12038)
. = ( 0xea4ac - code32flat_start ) ;
*32flat.*(.rodata.__func__.12032)
. = ( 0xea4c0 - code32flat_start ) ;
*32flat.*(.rodata.__func__.11962)
. = ( 0xea4d4 - code32flat_start ) ;
*32flat.*(.rodata.evt_separator.11567)
. = ( 0xea4d8 - code32flat_start ) ;
*32flat.*(.rodata.__func__.11408)
. = ( 0xea4ec - code32flat_start ) ;
*32flat.*(.rodata.__func__.10128)
. = ( 0xea500 - code32flat_start ) ;
*32flat.*(.rodata.__func__.9811)
. = ( 0xea510 - code32flat_start ) ;
*32flat.*(.rodata.__func__.9664)
. = ( 0xea524 - code32flat_start ) ;
*32flat.*(.rodata.__func__.9708)
. = ( 0xea534 - code32flat_start ) ;
*32flat.*(.rodata.__func__.9396)
. = ( 0xea544 - code32flat_start ) ;
*32flat.*(.rodata.__func__.9438)
. = ( 0xea550 - code32flat_start ) ;
*32flat.*(.rodata.__func__.9414)
. = ( 0xea560 - code32flat_start ) ;
*32flat.*(.rodata.__func__.9337)
. = ( 0xea574 - code32flat_start ) ;
*32flat.*(.rodata.__func__.9343)
. = ( 0xea58c - code32flat_start ) ;
*32flat.*(.rodata.__func__.9310)
. = ( 0xea5a0 - code32flat_start ) ;
*32flat.*(.rodata.__func__.9189)
. = ( 0xea5ac - code32flat_start ) ;
*32flat.*(.rodata.__func__.9118)
. = ( 0xea5b4 - code32flat_start ) ;
*32flat.*(.rodata.__func__.9015)
. = ( 0xea5c8 - code32flat_start ) ;
*32flat.*(.rodata.__func__.8893)
. = ( 0xea5d4 - code32flat_start ) ;
*32flat.*(.rodata.__func__.8603)
. = ( 0xea5e8 - code32flat_start ) ;
*32flat.*(.rodata.__func__.8449)
. = ( 0xea5f8 - code32flat_start ) ;
*32flat.*(.rodata.__func__.8456)
. = ( 0xea60c - code32flat_start ) ;
*32flat.*(.rodata.__func__.8315)
. = ( 0xea620 - code32flat_start ) ;
*32flat.*(.rodata.__func__.8232)
. = ( 0xea634 - code32flat_start ) ;
*32flat.*(.rodata.__func__.8165)
. = ( 0xea644 - code32flat_start ) ;
*32flat.*(.rodata.__func__.8051)
. = ( 0xea654 - code32flat_start ) ;
*32flat.*(.rodata.__func__.8081)
. = ( 0xea66c - code32flat_start ) ;
*32flat.*(.rodata.__func__.8115)
. = ( 0xea67c - code32flat_start ) ;
*32flat.*(.rodata.__func__.7862)
. = ( 0xea688 - code32flat_start ) ;
*32flat.*(.rodata.__func__.7633)
. = ( 0xea694 - code32flat_start ) ;
*32flat.*(.rodata.__func__.7585)
. = ( 0xea6a8 - code32flat_start ) ;
*32flat.*(.rodata.__func__.7425)
. = ( 0xea6b4 - code32flat_start ) ;
*32flat.*(.rodata.__func__.7325)
. = ( 0xea6c8 - code32flat_start ) ;
*32flat.*(.rodata.__func__.7038)
. = ( 0xea6e0 - code32flat_start ) ;
*32flat.*(.rodata.__func__.7065)
. = ( 0xea6f4 - code32flat_start ) ;
*32flat.*(.rodata.__func__.6977)
. = ( 0xea704 - code32flat_start ) ;
*32flat.*(.rodata.__func__.6994)
. = ( 0xea71c - code32flat_start ) ;
*32flat.*(.rodata.__func__.6838)
. = ( 0xea730 - code32flat_start ) ;
*32flat.*(.rodata.__func__.6712)
. = ( 0xea740 - code32flat_start ) ;
*32flat.*(.rodata.__func__.6749)
. = ( 0xea74c - code32flat_start ) ;
*32flat.*(.rodata.__func__.6762)
. = ( 0xea75c - code32flat_start ) ;
*32flat.*(.rodata.__func__.6776)
. = ( 0xea774 - code32flat_start ) ;
*32flat.*(.rodata.__func__.6587)
. = ( 0xea78c - code32flat_start ) ;
*32flat.*(.rodata.__func__.6613)
. = ( 0xea7a0 - code32flat_start ) ;
*32flat.*(.rodata.__func__.6547)
. = ( 0xea7b0 - code32flat_start ) ;
*32flat.*(.rodata.__func__.6559)
. = ( 0xea7c8 - code32flat_start ) ;
*32flat.*(.rodata.__func__.6413)
. = ( 0xea7dc - code32flat_start ) ;
*32flat.*(.rodata.__func__.6457)
. = ( 0xea7ec - code32flat_start ) ;
*32flat.*(.rodata.__func__.5771)
. = ( 0xea7f8 - code32flat_start ) ;
*32flat.*(.rodata.__func__.5884)
. = ( 0xea80c - code32flat_start ) ;
*32flat.*(.rodata.__func__.5752)
. = ( 0xea81c - code32flat_start ) ;
*32flat.*(.rodata.__func__.5813)
. = ( 0xea82c - code32flat_start ) ;
*32flat.*(.rodata.mem_power.5196)
. = ( 0xea834 - code32flat_start ) ;
*32flat.*(.rodata.__func__.3702)
. = ( 0xea844 - code32flat_start ) ;
*32flat.*(.rodata.__func__.3438)
. = ( 0xea850 - code32flat_start ) ;
*32flat.*(.rodata.__func__.3384)
. = ( 0xea864 - code32flat_start ) ;
*32flat.*(.rodata.__func__.2936)
. = ( 0xea880 - code32flat_start ) ;
*32flat.*(.rodata.acpi_find_tbl)
. = ( 0xea8c0 - code32flat_start ) ;
*32flat.*(.rodata.ssdp_misc_aml)
. = ( 0xeaa40 - code32flat_start ) ;
*32flat.*(.rodata.fadt_init_tbl)
. = ( 0xeaa80 - code32flat_start ) ;
*32flat.*(.rodata.AmlCode)
. = ( 0xebbc0 - code32flat_start ) ;
*32flat.*(.rodata.pci_platform_tbl)
. = ( 0xebc00 - code32flat_start ) ;
*32flat.*(.rodata.pci_device_tbl)
. = ( 0xebd18 - code32flat_start ) ;
*32flat.*(.rodata.pci_irqs)
. = ( 0xebd1c - code32flat_start ) ;
*32flat.*(.rodata.region_type_name)
. = ( 0xebd28 - code32flat_start ) ;
*32flat.*(.rodata.speed_to_xhci)
. = ( 0xebd40 - code32flat_start ) ;
*32flat.*(.rodata.speed_from_xhci)
. = ( 0xebd80 - code32flat_start ) ;
*32flat.*(.rodata.speed_name)
. = ( 0xebdc0 - code32flat_start ) ;
*32flat.*(.rodata.aaidct)
. = ( 0xebde0 - code32flat_start ) ;
*32flat.*(.rodata.zig)
. = ( 0xebe20 - code32flat_start ) ;
*32flat.*(.rodata.menuchars)
. = ( 0xebe60 - code32flat_start ) ;
*32flat.*(.rodata.pci_ata_tbl)
. = ( 0xebe9c - code32flat_start ) ;
*32flat.*(.rodata.speed_to_ctlsize)
. = ( 0xebeac - code32flat_start ) ;
*32flat.*(.data.prio_halt.9721)
. = ( 0xebec0 - code32flat_start ) ;
*32flat.*(.data.PIR_TABLE)
. = ( 0xebf40 - code32flat_start ) ;
*32flat.*(.data.ssdp_pcihp_aml)
. = ( 0xebfa0 - code32flat_start ) ;
*32flat.*(.data.ssdp_proc_aml)
. = ( 0xec018 - code32flat_start ) ;
*32flat.*(.data.pci_slot_get_irq)
. = ( 0xec020 - code32flat_start ) ;
*32flat.*(.data.pci_io_low_end)
. = ( 0xec028 - code32flat_start ) ;
*32flat.*(.data.pcimem64_end)
. = ( 0xec030 - code32flat_start ) ;
*32flat.*(.data.pcimem64_start)
. = ( 0xec038 - code32flat_start ) ;
*32flat.*(.data.pcimem_start)
. = ( 0xec040 - code32flat_start ) ;
*32flat.*(.data.HubOp)
. = ( 0xec050 - code32flat_start ) ;
*32flat.*(.data.xhci_hub_ops)
. = ( 0xec060 - code32flat_start ) ;
*32flat.*(.data.varinit../src/hw/pcidevice.c.16)
. = ( 0xec080 - code32flat_start ) ;
*32flat.*(.data.zig2)
. = ( 0xec0c0 - code32flat_start ) ;
*32flat.*(.data.varinit../src/boot.c.485)
. = ( 0xec0c4 - code32flat_start ) ;
*32flat.*(.data.DefaultBEVPrio)
. = ( 0xec0c8 - code32flat_start ) ;
*32flat.*(.data.DefaultHDPrio)
. = ( 0xec0cc - code32flat_start ) ;
*32flat.*(.data.DefaultCDPrio)
. = ( 0xec0d0 - code32flat_start ) ;
*32flat.*(.data.DefaultFloppyPrio)
. = ( 0xec0d4 - code32flat_start ) ;
*32flat.*(.data.varinit../src/boot.c.245)
. = ( 0xec0d8 - code32flat_start ) ;
*32flat.*(.data.varinit../src/boot.c.110)
. = ( 0xec0dc - code32flat_start ) ;
*32flat.*(.data.varinit../src/romfile.c.13)
. = ( 0xec0e0 - code32flat_start ) ;
*32flat.*(.data.RomEnd)
. = ( 0xec0e4 - code32flat_start ) ;
*32flat.*(.data.varinit../src/malloc.c.40)
. = ( 0xec0f8 - code32flat_start ) ;
*32flat.*(.data.varinit../src/malloc.c.38)
. = ( 0xec100 - code32flat_start ) ;
*32flat.*(.data.varinit../src/malloc.c.37)
. = ( 0xec104 - code32flat_start ) ;
*32flat.*(.data.varinit../src/malloc.c.36)
. = ( 0xec10c - code32flat_start ) ;
*32flat.*(.data.MptIOCInitRequest)
. = ( 0xec124 - code32flat_start ) ;
*32flat.*(.data.ehci_HubOp)
. = ( 0xec134 - code32flat_start ) ;
*32flat.*(.data.ohci_HubOp)
. = ( 0xec144 - code32flat_start ) ;
*32flat.*(.data.uhci_HubOp)
. = ( 0xec160 - code32flat_start ) ;
*32flat.*(.bss.used_bitmap.15385)
. = ( 0xec180 - code32flat_start ) ;
*32flat.*(.bss.ataid.8113)
. = ( 0xec184 - code32flat_start ) ;
*32flat.*(.bss.xen_hypercall_page)
. = ( 0xec188 - code32flat_start ) ;
*32flat.*(.bss.kvmclock)
. = ( 0xec190 - code32flat_start ) ;
*32flat.*(.bss.RamSizeOver4G)
. = ( 0xec198 - code32flat_start ) ;
*32flat.*(.bss.RamSize)
. = ( 0xec19c - code32flat_start ) ;
*32flat.*(.bss.SMBiosAddr)
. = ( 0xec1a0 - code32flat_start ) ;
*32flat.*(.bss.TPM_has_physical_presence)
. = ( 0xec1a4 - code32flat_start ) ;
*32flat.*(.bss.BootsplashActive)
. = ( 0xec1a8 - code32flat_start ) ;
*32flat.*(.bss.HaveFDBoot)
. = ( 0xec1ac - code32flat_start ) ;
*32flat.*(.bss.HaveHDBoot)
. = ( 0xec1b0 - code32flat_start ) ;
*32flat.*(.bss.BootorderCount)
. = ( 0xec1b4 - code32flat_start ) ;
*32flat.*(.bss.BiosGeometryCount)
. = ( 0xec1b8 - code32flat_start ) ;
*32flat.*(.bss.RunPCIroms)
. = ( 0xec1bc - code32flat_start ) ;
*32flat.*(.bss.SpinupEnd)
. = ( 0xec1c0 - code32flat_start ) ;
*32flat.*(.bss.PendingEHCI)
. = ( 0xec1c4 - code32flat_start ) ;
*32flat.*(.bss.usb_time_sigatt)
. = ( 0xec1c8 - code32flat_start ) ;
*32flat.*(.bss.CDCount)
. = ( 0xec1e0 - code32flat_start ) ;
*32flat.*(.text.set_a20)
. = ( 0xec1fa - code32flat_start ) ;
*32flat.*(.text.runningOnXen)
. = ( 0xec205 - code32flat_start ) ;
*32flat.*(.text.switch_next)
. = ( 0xec223 - code32flat_start ) ;
*32flat.*(.text.putc)
. = ( 0xec228 - code32flat_start ) ;
*32flat.*(.text.putsinglehex)
. = ( 0xec23a - code32flat_start ) ;
*32flat.*(.text.puthex)
. = ( 0xec2bd - code32flat_start ) ;
*32flat.*(.text.putprettyhex)
. = ( 0xec304 - code32flat_start ) ;
*32flat.*(.text.strlen)
. = ( 0xec313 - code32flat_start ) ;
*32flat.*(.text.strcmp)
. = ( 0xec333 - code32flat_start ) ;
*32flat.*(.text.memset)
. = ( 0xec33e - code32flat_start ) ;
*32flat.*(.text.pci_config_writel)
. = ( 0xec361 - code32flat_start ) ;
*32flat.*(.text.pci_config_writew)
. = ( 0xec38d - code32flat_start ) ;
*32flat.*(.text.pci_config_writeb)
. = ( 0xec3b8 - code32flat_start ) ;
*32flat.*(.text.pci_config_readl)
. = ( 0xec3d9 - code32flat_start ) ;
*32flat.*(.text.pci_config_readw)
. = ( 0xec401 - code32flat_start ) ;
*32flat.*(.text.pci_config_readb)
. = ( 0xec428 - code32flat_start ) ;
*32flat.*(.text.pci_next)
. = ( 0xec46e - code32flat_start ) ;
*32flat.*(.text.scsi_is_read)
. = ( 0xec48f - code32flat_start ) ;
*32flat.*(.text.rom_get_max)
. = ( 0xec4a0 - code32flat_start ) ;
*32flat.*(.text.cpuid)
. = ( 0xec4f7 - code32flat_start ) ;
*32flat.*(.text.ahci_port_readl)
. = ( 0xec507 - code32flat_start ) ;
*32flat.*(.text.ahci_port_writel)
. = ( 0xec51d - code32flat_start ) ;
*32flat.*(.text.find_acpi_table)
. = ( 0xec574 - code32flat_start ) ;
*32flat.*(.text.make_bios_readonly_intel)
. = ( 0xec612 - code32flat_start ) ;
*32flat.*(.text.mch_isa_lpc_setup)
. = ( 0xec652 - code32flat_start ) ;
*32flat.*(.text.piix4_pm_config_setup)
. = ( 0xec6bf - code32flat_start ) ;
*32flat.*(.text.ich9_smbus_enable)
. = ( 0xec6f1 - code32flat_start ) ;
*32flat.*(.text.smp_write_msrs)
. = ( 0xec717 - code32flat_start ) ;
*32flat.*(.text.apic_id_init)
. = ( 0xec78e - code32flat_start ) ;
*32flat.*(.text._vp_read)
. = ( 0xec902 - code32flat_start ) ;
*32flat.*(.text._vp_write)
. = ( 0xeca12 - code32flat_start ) ;
*32flat.*(.text.vp_notify)
. = ( 0xecade - code32flat_start ) ;
*32flat.*(.text.crb_get_tpm_version)
. = ( 0xecae1 - code32flat_start ) ;
*32flat.*(.text.crb_activate)
. = ( 0xecaf1 - code32flat_start ) ;
*32flat.*(.text.crb_waitdatavalid)
. = ( 0xecaf4 - code32flat_start ) ;
*32flat.*(.text.nvme_commit_sqe)
. = ( 0xecb0b - code32flat_start ) ;
*32flat.*(.text.tpm_log_event)
. = ( 0xecb7a - code32flat_start ) ;
*32flat.*(.text.smm_save_and_copy)
. = ( 0xecbcc - code32flat_start ) ;
*32flat.*(.text.smm_relocate_and_restore)
. = ( 0xecc2e - code32flat_start ) ;
*32flat.*(.text.set_timeouts)
. = ( 0xecc85 - code32flat_start ) ;
*32flat.*(.text.cpu_to_be32)
. = ( 0xecc88 - code32flat_start ) ;
*32flat.*(.text.sha1_block)
. = ( 0xecdec - code32flat_start ) ;
*32flat.*(.text.tpmhw_transmit)
. = ( 0xece5f - code32flat_start ) ;
*32flat.*(.text.tpm_build_digest)
. = ( 0xecfc4 - code32flat_start ) ;
*32flat.*(.text.sha1_do)
. = ( 0xed0ab - code32flat_start ) ;
*32flat.*(.text.sha1)
. = ( 0xed0e0 - code32flat_start ) ;
*32flat.*(.text.tpm_simple_cmd)
. = ( 0xed18a - code32flat_start ) ;
*32flat.*(.text.threads_during_optionroms)
. = ( 0xed1a2 - code32flat_start ) ;
*32flat.*(.text.default_process_op.isra.5)
. = ( 0xed1c1 - code32flat_start ) ;
*32flat.*(.text.code_mutable_preinit)
. = ( 0xed1dd - code32flat_start ) ;
*32flat.*(.text.vp_get_isr)
. = ( 0xed202 - code32flat_start ) ;
*32flat.*(.text.tis_get_tpm_version)
. = ( 0xed229 - code32flat_start ) ;
*32flat.*(.text.__make_bios_writable_intel)
. = ( 0xed2b2 - code32flat_start ) ;
*32flat.*(.text.make_bios_writable_intel)
. = ( 0xed2d8 - code32flat_start ) ;
*32flat.*(.text.smm_setup)
. = ( 0xed3d9 - code32flat_start ) ;
*32flat.*(.text.crb_senddata)
. = ( 0xed404 - code32flat_start ) ;
*32flat.*(.text.init_timeout)
. = ( 0xed457 - code32flat_start ) ;
*32flat.*(.text.crb_init)
. = ( 0xed487 - code32flat_start ) ;
*32flat.*(.text.tis_init)
. = ( 0xed49b - code32flat_start ) ;
*32flat.*(.text.scsi_fill_cmd)
. = ( 0xed4fc - code32flat_start ) ;
*32flat.*(.text.crb_readresp)
. = ( 0xed55a - code32flat_start ) ;
*32flat.*(.text.pic_reset.constprop.167)
. = ( 0xed57f - code32flat_start ) ;
*32flat.*(.text.vring_get_buf.constprop.175)
. = ( 0xed5de - code32flat_start ) ;
*32flat.*(.text.checksum)
. = ( 0xed5f1 - code32flat_start ) ;
*32flat.*(.text.tpm_extend)
. = ( 0xed705 - code32flat_start ) ;
*32flat.*(.text.hash_log_extend.isra.115.part.116)
. = ( 0xed7aa - code32flat_start ) ;
*32flat.*(.text.tpm20_hierarchycontrol.constprop.201)
. = ( 0xed835 - code32flat_start ) ;
*32flat.*(.text.tpm_set_failure)
. = ( 0xed874 - code32flat_start ) ;
*32flat.*(.text.tpm_add_measurement_to_log)
. = ( 0xed91b - code32flat_start ) ;
*32flat.*(.text.tpm_add_action)
. = ( 0xed93b - code32flat_start ) ;
*32flat.*(.text.debug_putc)
. = ( 0xed94b - code32flat_start ) ;
*32flat.*(.text.irqtimer_calc.part.15)
. = ( 0xed987 - code32flat_start ) ;
*32flat.*(.text.rtc_use)
. = ( 0xed9a5 - code32flat_start ) ;
*32flat.*(.text.timer_read)
. = ( 0xeda14 - code32flat_start ) ;
*32flat.*(.text.timer_calc)
. = ( 0xeda27 - code32flat_start ) ;
*32flat.*(.text.timer_calc_usec)
. = ( 0xeda6e - code32flat_start ) ;
*32flat.*(.text.timer_check)
. = ( 0xeda82 - code32flat_start ) ;
*32flat.*(.text.timer_delay)
. = ( 0xeda96 - code32flat_start ) ;
*32flat.*(.text.udelay)
. = ( 0xedaa0 - code32flat_start ) ;
*32flat.*(.text.ndelay.constprop.177)
. = ( 0xedac8 - code32flat_start ) ;
*32flat.*(.text.putuint)
. = ( 0xedb0f - code32flat_start ) ;
*32flat.*(.text.bvprintf)
. = ( 0xedd87 - code32flat_start ) ;
*32flat.*(.text.panic)
. = ( 0xedd9d - code32flat_start ) ;
*32flat.*(.text.call16)
. = ( 0xede17 - code32flat_start ) ;
*32flat.*(.text.__call16_int)
. = ( 0xede39 - code32flat_start ) ;
*32flat.*(.text.screenc)
. = ( 0xede91 - code32flat_start ) ;
*32flat.*(.text.screen_putc)
. = ( 0xedec4 - code32flat_start ) ;
*32flat.*(.text.yield)
. = ( 0xedefe - code32flat_start ) ;
*32flat.*(.text.finish_preempt)
. = ( 0xedf34 - code32flat_start ) ;
*32flat.*(.text.usleep)
. = ( 0xedf50 - code32flat_start ) ;
*32flat.*(.text.qemu_cfg_dma_transfer)
. = ( 0xedfa5 - code32flat_start ) ;
*32flat.*(.text.qemu_cfg_skip)
. = ( 0xedfd5 - code32flat_start ) ;
*32flat.*(.text.qemu_cfg_read.part.125)
. = ( 0xedff6 - code32flat_start ) ;
*32flat.*(.text.qemu_cfg_read_entry)
. = ( 0xee033 - code32flat_start ) ;
*32flat.*(.text.qemu_get_present_cpus_count)
. = ( 0xee074 - code32flat_start ) ;
*32flat.*(.text.yield_toirq)
. = ( 0xee09c - code32flat_start ) ;
*32flat.*(.text.reset)
. = ( 0xee0af - code32flat_start ) ;
*32flat.*(.text.call16_override)
. = ( 0xee0ea - code32flat_start ) ;
*32flat.*(.text.vring_add_buf.constprop.173)
. = ( 0xee1f9 - code32flat_start ) ;
*32flat.*(.text.__dprintf)
. = ( 0xee20c - code32flat_start ) ;
*32flat.*(.text.debug_banner)
. = ( 0xee22e - code32flat_start ) ;
*32flat.*(.text.__warn_internalerror)
. = ( 0xee23e - code32flat_start ) ;
*32flat.*(.text.qemu_cfg_write_entry)
. = ( 0xee269 - code32flat_start ) ;
*32flat.*(.text.qemu_cfg_write)
. = ( 0xee290 - code32flat_start ) ;
*32flat.*(.text.nvme_get_next_sqe.constprop.176)
. = ( 0xee30b - code32flat_start ) ;
*32flat.*(.text.__warn_noalloc)
. = ( 0xee31b - code32flat_start ) ;
*32flat.*(.text.__warn_timeout)
. = ( 0xee32b - code32flat_start ) ;
*32flat.*(.text.i8042_wait_write)
. = ( 0xee35c - code32flat_start ) ;
*32flat.*(.text.uhci_waittick)
. = ( 0xee3a5 - code32flat_start ) ;
*32flat.*(.text.ohci_waittick)
. = ( 0xee3ed - code32flat_start ) ;
*32flat.*(.text.ehci_waittick.isra.63)
. = ( 0xee46b - code32flat_start ) ;
*32flat.*(.text.await_ide.constprop.180)
. = ( 0xee4bf - code32flat_start ) ;
*32flat.*(.text.await_not_bsy)
. = ( 0xee4ce - code32flat_start ) ;
*32flat.*(.text.send_cmd)
. = ( 0xee592 - code32flat_start ) ;
*32flat.*(.text.ata_pio_transfer.constprop.179)
. = ( 0xee625 - code32flat_start ) ;
*32flat.*(.text.ata_wait_data)
. = ( 0xee651 - code32flat_start ) ;
*32flat.*(.text.ahci_command)
. = ( 0xee86f - code32flat_start ) ;
*32flat.*(.text.ahci_disk_readwrite_aligned)
. = ( 0xee957 - code32flat_start ) ;
*32flat.*(.text.ahci_disk_readwrite)
. = ( 0xeea24 - code32flat_start ) ;
*32flat.*(.text.sdcard_reset)
. = ( 0xeea62 - code32flat_start ) ;
*32flat.*(.text.wait_reg8)
. = ( 0xeeaaf - code32flat_start ) ;
*32flat.*(.text.crb_probe)
. = ( 0xeeb18 - code32flat_start ) ;
*32flat.*(.text.tis_activate)
. = ( 0xeeb84 - code32flat_start ) ;
*32flat.*(.text.tis_find_active_locality)
. = ( 0xeebab - code32flat_start ) ;
*32flat.*(.text.tis_readresp)
. = ( 0xeebea - code32flat_start ) ;
*32flat.*(.text.tis_probe)
. = ( 0xeec48 - code32flat_start ) ;
*32flat.*(.text.crb_waitrespready)
. = ( 0xeec64 - code32flat_start ) ;
*32flat.*(.text.crb_ready)
. = ( 0xeec89 - code32flat_start ) ;
*32flat.*(.text.tis_waitdatavalid)
. = ( 0xeecbd - code32flat_start ) ;
*32flat.*(.text.tis_ready)
. = ( 0xeecf1 - code32flat_start ) ;
*32flat.*(.text.tis_waitrespready)
. = ( 0xeed31 - code32flat_start ) ;
*32flat.*(.text.tis_senddata)
. = ( 0xeedce - code32flat_start ) ;
*32flat.*(.text.nvme_wait)
. = ( 0xeeeb9 - code32flat_start ) ;
*32flat.*(.text.wait_td)
. = ( 0xeef0d - code32flat_start ) ;
*32flat.*(.text.uhci_send_pipe)
. = ( 0xef1a1 - code32flat_start ) ;
*32flat.*(.text.ohci_send_pipe)
. = ( 0xef381 - code32flat_start ) ;
*32flat.*(.text.ehci_send_pipe)
. = ( 0xef5f0 - code32flat_start ) ;
*32flat.*(.text.megasas_fire_cmd)
. = ( 0xef68d - code32flat_start ) ;
*32flat.*(.text.is_valid_rom.part.81)
. = ( 0xef6d5 - code32flat_start ) ;
*32flat.*(.text.call_boot_entry)
. = ( 0xef737 - code32flat_start ) ;
*32flat.*(.text.sdcard_waitw)
. = ( 0xef79f - code32flat_start ) ;
*32flat.*(.text.make_bios_readonly)
. = ( 0xef7e9 - code32flat_start ) ;
*32flat.*(.text.xhci_process_events)
. = ( 0xef8d8 - code32flat_start ) ;
*32flat.*(.text.xhci_event_wait)
. = ( 0xef930 - code32flat_start ) ;
*32flat.*(.text.sdcard_pio)
. = ( 0xef9ab - code32flat_start ) ;
*32flat.*(.text.sdcard_pio_transfer)
. = ( 0xefabf - code32flat_start ) ;
*32flat.*(.text.make_bios_writable)
. = ( 0xefb2f - code32flat_start ) ;
*32flat.*(.text.smp_scan)
. = ( 0xefc48 - code32flat_start ) ;
*32flat.*(.text.mch_mmconfig_setup)
. = ( 0xefc94 - code32flat_start ) ;
*32flat.*(.text.printf)
. = ( 0xefca7 - code32flat_start ) ;
*32flat.*(.text.boot_fail)
. = ( 0xefd28 - code32flat_start ) ;
*32flat.*(.text.boot_disk)
. = ( 0xefe26 - code32flat_start ) ;
*32flat.*(.text.__callrom)
. = ( 0xefed7 - code32flat_start ) ;
*32flat.*(.text.virtio_blk_op)
. = ( 0xeffb2 - code32flat_start ) ;
*32flat.*(.text.xhci_trb_queue)
. = ( 0xf0055 - code32flat_start ) ;
*32flat.*(.text.xhci_xfer_normal)
. = ( 0xf007f - code32flat_start ) ;
*32flat.*(.text.usb_send_pipe)
. = ( 0xf01c8 - code32flat_start ) ;
*32flat.*(.text.usb_process_op)
. = ( 0xf02e3 - code32flat_start ) ;
*32flat.*(.text.uas_process_op)
. = ( 0xf0458 - code32flat_start ) ;
*32flat.*(.text.runtime../src/stacks.c.757)
. = ( 0xf0468 - code32flat_start ) ;
*32flat.*(.text.runtime../src/block.c.571)
. = ( 0xf102a - code32flat_start ) ;
*32flat.*(.text.process_op)
. = ( 0xf106b - code32flat_start ) ;
*32flat.*(.text.scsi_is_ready)
. = ( 0xf116c - code32flat_start ) ;
*32flat.*(.text.cdrom_boot)
. = ( 0xf1474 - code32flat_start ) ;
*32flat.*(.text.do_boot)
. = ( 0xf15e7 - code32flat_start ) ;
*32flat.*(.text.runtime../src/resume.c.146)
. = ( 0xf1944 - code32flat_start ) ;
*32flat.*(.text.runtime../src/post.c.182)
. = ( 0xf1984 - code32flat_start ) ;
*32flat.*(.text.runtime../src/post.c.320)
. = ( 0xf1a59 - code32flat_start ) ;
*32flat.*(.text.runtime../src/boot.c.995)
. = ( 0xf1a85 - code32flat_start ) ;
*32flat.*(.text.runtime../src/boot.c.1005)
. = ( 0xf1ab2 - code32flat_start ) ;
*32flat.*(.text.runtime../src/tcgbios.c.1593)
. = ( 0xf1dec - code32flat_start ) ;
*32flat.*(.text.runtime../src/hw/usb-xhci.c.1131)
. = ( 0xf1e56 - code32flat_start ) ;
*32flat.*(.text.runtime../src/fw/smm.c.62)
. = ( 0xf20c2 - code32flat_start ) ;
*32flat.*(.text.runtime../src/fw/smp.c.83)
. = ( 0xf20e0 - code32flat_start ) ;
_rodata32flat = . ;
*32flat.*(.rodata)
. = ( 0xf4fd0 - code32flat_start ) ;
*32flat.*(.rodata.puthex)
. = ( 0xf4fec - code32flat_start ) ;
*32flat.*(.rodata.runtime../src/tcgbios.c.1593)
. = ( 0xf500c - code32flat_start ) ;
*32flat.*(.rodata.__func__.16466)
. = ( 0xf5018 - code32flat_start ) ;
*32flat.*(.rodata.__func__.16477)
. = ( 0xf502c - code32flat_start ) ;
*32flat.*(.rodata.__func__.16546)
. = ( 0xf5040 - code32flat_start ) ;
*32flat.*(.rodata.__func__.16219)
. = ( 0xf5050 - code32flat_start ) ;
*32flat.*(.rodata.__func__.16140)
. = ( 0xf505c - code32flat_start ) ;
*32flat.*(.rodata.__func__.14910)
. = ( 0xf5068 - code32flat_start ) ;
*32flat.*(.rodata.__func__.14184)
. = ( 0xf5078 - code32flat_start ) ;
*32flat.*(.rodata.__func__.14203)
. = ( 0xf5090 - code32flat_start ) ;
*32flat.*(.rodata.__func__.12980)
. = ( 0xf50a0 - code32flat_start ) ;
*32flat.*(.rodata.__func__.12987)
. = ( 0xf50b0 - code32flat_start ) ;
*32flat.*(.rodata.__func__.12850)
. = ( 0xf50c0 - code32flat_start ) ;
*32flat.*(.rodata.__func__.12667)
. = ( 0xf50d4 - code32flat_start ) ;
*32flat.*(.rodata.__func__.12689)
. = ( 0xf50e4 - code32flat_start ) ;
*32flat.*(.rodata.__func__.12102)
. = ( 0xf50f4 - code32flat_start ) ;
*32flat.*(.rodata.sha_ko.11916)
. = ( 0xf5104 - code32flat_start ) ;
*32flat.*(.rodata.__func__.10023)
. = ( 0xf5110 - code32flat_start ) ;
*32flat.*(.rodata.__func__.10018)
. = ( 0xf511c - code32flat_start ) ;
*32flat.*(.rodata.__func__.8421)
. = ( 0xf5130 - code32flat_start ) ;
*32flat.*(.rodata.__func__.7836)
. = ( 0xf513c - code32flat_start ) ;
*32flat.*(.rodata.__func__.7080)
. = ( 0xf514c - code32flat_start ) ;
*32flat.*(.rodata.__func__.7112)
. = ( 0xf515c - code32flat_start ) ;
*32flat.*(.rodata.__func__.6949)
. = ( 0xf516c - code32flat_start ) ;
*32flat.*(.rodata.__func__.6845)
. = ( 0xf5174 - code32flat_start ) ;
*32flat.*(.rodata.__func__.6865)
. = ( 0xf5184 - code32flat_start ) ;
*32flat.*(.rodata.__func__.6727)
. = ( 0xf5194 - code32flat_start ) ;
*32flat.*(.rodata.__func__.6620)
. = ( 0xf51a0 - code32flat_start ) ;
*32flat.*(.rodata.__func__.6630)
. = ( 0xf51a8 - code32flat_start ) ;
*32flat.*(.rodata.__func__.6516)
. = ( 0xf51b8 - code32flat_start ) ;
*32flat.*(.rodata.__func__.5761)
. = ( 0xf51cc - code32flat_start ) ;
*32flat.*(.rodata.tpm_default_durations)
. = ( 0xf51d8 - code32flat_start ) ;
*32flat.*(.rodata.tis_default_timeouts)
. = ( 0xf5200 - code32flat_start ) ;
*32flat.*(.rodata.hash_parameters)
. = ( 0xf5228 - code32flat_start ) ;
*32flat.*(.data.TPMHW_driver_to_use)
. = ( 0xf5240 - code32flat_start ) ;
*32flat.*(.data.tpm_drivers)
. = ( 0xf52a0 - code32flat_start ) ;
*32flat.*(.data.SMMPMDeviceBDF)
. = ( 0xf52a4 - code32flat_start ) ;
*32flat.*(.data.SMMISADeviceBDF)
. = ( 0xf52a8 - code32flat_start ) ;
*32flat.*(.data.MCHMmcfgBDF)
. = ( 0xf52ac - code32flat_start ) ;
*32flat.*(.data.ICH9SmbusBDF)
. = ( 0xf52b0 - code32flat_start ) ;
*32flat.*(.data.PiixPmBDF)
. = ( 0xf52b4 - code32flat_start ) ;
*32flat.*(.data.ICH9LpcBDF)
. = ( 0xf52b8 - code32flat_start ) ;
*32flat.*(.data.ShadowBDF)
. = ( 0xf52bc - code32flat_start ) ;
*32flat.*(.data.acpi_pm_base)
. = ( 0xf52c0 - code32flat_start ) ;
*32flat.*(.data.CheckFloppySig)
. = ( 0xf52c4 - code32flat_start ) ;
*32flat.*(.data.screeninfo)
. = ( 0xf52c8 - code32flat_start ) ;
*32flat.*(.data.debuginfo)
. = ( 0xf52e0 - code32flat_start ) ;
*32flat.*(.data.BUILDINFO)
. = ( 0xf5334 - code32flat_start ) ;
*32flat.*(.data.VERSION)
. = ( 0xf534c - code32flat_start ) ;
*32flat.*(.bss.crb_resp)
. = ( 0xf5350 - code32flat_start ) ;
*32flat.*(.bss.crb_cmd)
. = ( 0xf5354 - code32flat_start ) ;
*32flat.*(.bss.crb_cmd_size)
. = ( 0xf5358 - code32flat_start ) ;
*32flat.*(.bss.tpm_default_to)
. = ( 0xf5368 - code32flat_start ) ;
*32flat.*(.bss.tpm_default_dur)
. = ( 0xf5374 - code32flat_start ) ;
*32flat.*(.bss.romfile_pointer_list)
. = ( 0xf5378 - code32flat_start ) ;
*32flat.*(.bss.xen_cpuid_base)
. = ( 0xf537c - code32flat_start ) ;
*32flat.*(.bss.SMPStack)
. = ( 0xf5380 - code32flat_start ) ;
*32flat.*(.bss.SMPLock)
. = ( 0xf53a0 - code32flat_start ) ;
*32flat.*(.bss.FoundAPICIDs)
. = ( 0xf53c0 - code32flat_start ) ;
*32flat.*(.bss.CountCPUs)
. = ( 0xf53c4 - code32flat_start ) ;
*32flat.*(.bss.MaxCountCPUs)
. = ( 0xf53c8 - code32flat_start ) ;
*32flat.*(.bss.smp_msr_count)
. = ( 0xf53e0 - code32flat_start ) ;
*32flat.*(.bss.smp_msr)
. = ( 0xf5560 - code32flat_start ) ;
*32flat.*(.bss.cfg_dma_enabled)
. = ( 0xf5564 - code32flat_start ) ;
*32flat.*(.bss.cfg_enabled)
. = ( 0xf5568 - code32flat_start ) ;
*32flat.*(.bss.acpi_reset_val)
. = ( 0xf556c - code32flat_start ) ;
*32flat.*(.bss.acpi_reset_reg)
. = ( 0xf5578 - code32flat_start ) ;
*32flat.*(.bss.RsdpAddr)
. = ( 0xf557c - code32flat_start ) ;
*32flat.*(.bss.tpm20_pcr_selection)
. = ( 0xf5580 - code32flat_start ) ;
*32flat.*(.bss.tpm20_pcr_selection_size)
. = ( 0xf5584 - code32flat_start ) ;
*32flat.*(.bss.TPM_version)
. = ( 0xf5588 - code32flat_start ) ;
*32flat.*(.bss.BEVCount)
. = ( 0xf55a0 - code32flat_start ) ;
*32flat.*(.bss.BEV)
. = ( 0xf5640 - code32flat_start ) ;
*32flat.*(.bss.BootRetryTime)
. = ( 0xf5644 - code32flat_start ) ;
*32flat.*(.bss.VgaROM)
. = ( 0xf5648 - code32flat_start ) ;
*32flat.*(.bss.ScreenAndDebug)
. = ( 0xf564c - code32flat_start ) ;
*32flat.*(.bss.S3ResumeVga)
. = ( 0xf5650 - code32flat_start ) ;
*32flat.*(.bss.EnforceChecksum)
. = ( 0xf5654 - code32flat_start ) ;
*32flat.*(.bss.RomBase)
. = ( 0xf5658 - code32flat_start ) ;
*32flat.*(.bss.PreemptCount)
. = ( 0xf565c - code32flat_start ) ;
*32flat.*(.bss.ThreadControl)
. = ( 0xf565d - code32flat_start ) ;
*32flat.*(.bss.CanInterrupt)
. = ( 0xf5e60 - code32flat_start ) ;
*32flat.*(.data.varfseg../src/fw/paravirt.c.35)
. = ( 0xf5e64 - code32flat_start ) ;
*32flat.*(.data.varfseg../src/fw/biostables.c.177)
. = ( 0xf5e68 - code32flat_start ) ;
*32flat.*(.data.varfseg../src/fw/biostables.c.22)
. = ( 0xf5e6c - code32flat_start ) ;
*32flat.*(.data.varfseg../src/hw/pcidevice.c.17)
. = ( 0xf5e70 - code32flat_start ) ;
*32flat.*(.data.varfseg../src/pmm.c.20)
. = ( 0xf5e80 - code32flat_start ) ;
*32flat.*(.data.varfseg../src/malloc.c.468)
. = ( 0xf5e84 - code32flat_start ) ;
*32flat.*(.data.varfseg../src/e820map.c.19)
. = ( 0xf5ea0 - code32flat_start ) ;
*32flat.*(.data.varfseg../src/e820map.c.18)
. = ( 0xf6120 - code32flat_start ) ;
*32flat.*(.data.varfseg../src/hw/floppy.c.88)
. = ( 0xf617c - code32flat_start ) ;
*32flat.*(.data.varfseg../src/hw/floppy.c.55)
. = ( 0xf618c - code32flat_start ) ;
*32flat.*(.data.varfseg../src/hw/usb-hid.c.16)
. = ( 0xf6190 - code32flat_start ) ;
*32flat.*(.data.varfseg../src/hw/usb-hid.c.15)
. = ( 0xf6194 - code32flat_start ) ;
*32flat.*(.data.varfseg../src/hw/serialio.c.104)
. = ( 0xf6196 - code32flat_start ) ;
*32flat.*(.data.varfseg../src/hw/timer.c.54)
. = ( 0xf6198 - code32flat_start ) ;
*32flat.*(.data.varfseg../src/hw/timer.c.53)
. = ( 0xf619c - code32flat_start ) ;
*32flat.*(.data.varfseg../src/hw/timer.c.52)
. = ( 0xf61a0 - code32flat_start ) ;
*32flat.*(.data.varfseg../src/pcibios.c.229)
. = ( 0xf61b0 - code32flat_start ) ;
*32flat.*(.data.varfseg../src/vgahooks.c.262)
. = ( 0xf61b1 - code32flat_start ) ;
*32flat.*(.data.varfseg../src/vgahooks.c.179)
. = ( 0xf61b4 - code32flat_start ) ;
*32flat.*(.data.varfseg../src/vgahooks.c.40)
. = ( 0xf61bc - code32flat_start ) ;
*32flat.*(.data.varfseg../src/vgahooks.c.22)
. = ( 0xf61c0 - code32flat_start ) ;
*32flat.*(.data.varfseg../src/pnpbios.c.18)
. = ( 0xf61e4 - code32flat_start ) ;
*32flat.*(.data.varfseg../src/sercon.c.52)
. = ( 0xf61e8 - code32flat_start ) ;
*32flat.*(.data.varfseg../src/cdrom.c.27)
. = ( 0xf61ec - code32flat_start ) ;
*32flat.*(.data.varfseg../src/block.c.34)
. = ( 0xf6200 - code32flat_start ) ;
*32flat.*(.data.varfseg../src/block.c.33)
. = ( 0xf62c0 - code32flat_start ) ;
*32flat.*(.data.varfseg../src/block.c.31)
. = ( 0xf62c4 - code32flat_start ) ;
*32flat.*(.data.varfseg../src/stacks.c.691)
. = ( 0xf62c8 - code32flat_start ) ;
*32flat.*(.data.varfseg../src/stacks.c.476)
. = ( 0xf62d4 - code32flat_start ) ;
*32flat.*(.data.varfseg../src/stacks.c.38)
. = ( 0xf62d8 - code32flat_start ) ;
*32flat.*(.data.varfseg../src/misc.c.166)
. = ( 0xf62e0 - code32flat_start ) ;
*32flat.*(.data.varfseg../src/misc.c.148)
. = ( 0xf6318 - code32flat_start ) ;
*32flat.*(.data.varfseg../src/misc.c.142)
. = ( 0xf631e - code32flat_start ) ;
*32flat.*(.data.varfseg../src/misc.c.139)
. = ( 0xf6320 - code32flat_start ) ;
*32flat.*(.data.varfseg../src/misc.c.132)
. = ( 0xf6328 - code32flat_start ) ;
*32flat.*(.data.varfseg../src/misc.c.18)
. = ( 0xf6330 - code32flat_start ) ;
*32flat.*(.text.32fseg../src/stacks.c.215)
. = ( 0xf6356 - code32flat_start ) ;
*32flat.*(.text.32fseg../src/stacks.c.300)
. = ( 0xf6382 - code32flat_start ) ;
*32seg.*(.text.set_code_success)
. = ( 0xf638c - code32flat_start ) ;
*32seg.*(.text.get_global_offset)
. = ( 0xf6398 - code32flat_start ) ;
*32seg.*(.text.qemu_debug_putc)
. = ( 0xf63b0 - code32flat_start ) ;
*32seg.*(.text.pci_config_readl)
. = ( 0xf63d1 - code32flat_start ) ;
*32seg.*(.text.putsinglehex.isra.8)
. = ( 0xf63e4 - code32flat_start ) ;
*32seg.*(.text.puthex.isra.9)
. = ( 0xf6469 - code32flat_start ) ;
*32seg.*(.text.pci_next)
. = ( 0xf64dd - code32flat_start ) ;
*32seg.*(.text.putuint.isra.11)
. = ( 0xf6513 - code32flat_start ) ;
*32seg.*(.text.__dprintf)
. = ( 0xf6767 - code32flat_start ) ;
*32seg.*(.text.handle_pcibios)
. = ( 0xf6a5d - code32flat_start ) ;
*32seg.*(.text.handle_apm)
. = ( 0xf6bd6 - code32flat_start ) ;
_rodata32seg = . ;
*32seg.*(.rodata)
. = ( 0xf6c00 - code32flat_start ) ;
*16.*(.text.set_a20)
. = ( 0xf6c20 - code32flat_start ) ;
*16.*(.text.set_code_success)
. = ( 0xf6c2c - code32flat_start ) ;
*16.*(.text.call32_prep)
. = ( 0xf6cc5 - code32flat_start ) ;
*16.*(.text.memset)
. = ( 0xf6cd4 - code32flat_start ) ;
*16.*(.text.enqueue_key)
. = ( 0xf6d2c - code32flat_start ) ;
*16.*(.text.kbd_set_flag)
. = ( 0xf6d8b - code32flat_start ) ;
*16.*(.text.handle_1524XX)
. = ( 0xf6d97 - code32flat_start ) ;
*16.*(.text.cursor_pos_row)
. = ( 0xf6da8 - code32flat_start ) ;
*16.*(.text.irqtimer_check)
. = ( 0xf6de1 - code32flat_start ) ;
*16.*(.text.qemu_debug_putc)
. = ( 0xf6ded - code32flat_start ) ;
*16.*(.text.ehci_reset_pipe)
. = ( 0xf6e32 - code32flat_start ) ;
*16.*(.text.lba2chs)
. = ( 0xf6e76 - code32flat_start ) ;
*16.*(.text.scsi_fill_cmd)
. = ( 0xf6eed - code32flat_start ) ;
*16.*(.text.on_extra_stack)
. = ( 0xf6f11 - code32flat_start ) ;
*16.*(.text.__stack_hop_back)
. = ( 0xf6f73 - code32flat_start ) ;
*16.*(.text.default_process_op.isra.8)
. = ( 0xf6f94 - code32flat_start ) ;
*16.*(.text.__disk_ret.isra.9)
. = ( 0xf6fc3 - code32flat_start ) ;
*16.*(.text.__disk_ret_unimplemented.isra.10)
. = ( 0xf6feb - code32flat_start ) ;
*16.*(.text.getLCHS)
. = ( 0xf7092 - code32flat_start ) ;
*16.*(.text.disk_1308)
. = ( 0xf71cc - code32flat_start ) ;
*16.*(.text.disk_1315)
. = ( 0xf722e - code32flat_start ) ;
*16.*(.text.getComAddr)
. = ( 0xf7260 - code32flat_start ) ;
*16.*(.text.getLptAddr)
. = ( 0xf7293 - code32flat_start ) ;
*16.*(.text.pci_config_readl)
. = ( 0xf72be - code32flat_start ) ;
*16.*(.text.putsinglehex.isra.50)
. = ( 0xf72d5 - code32flat_start ) ;
*16.*(.text.puthex.isra.51)
. = ( 0xf737b - code32flat_start ) ;
*16.*(.text.puts_cs.isra.54)
. = ( 0xf7396 - code32flat_start ) ;
*16.*(.text.clear_usertimer)
. = ( 0xf73d7 - code32flat_start ) ;
*16.*(.text.call32_post)
. = ( 0xf747a - code32flat_start ) ;
*16.*(.text.floppy_dor_mask)
. = ( 0xf749d - code32flat_start ) ;
*16.*(.text.floppy_disable_controller)
. = ( 0xf74a9 - code32flat_start ) ;
*16.*(.text.set_usertimer)
. = ( 0xf752c - code32flat_start ) ;
*16.*(.text.pci_next)
. = ( 0xf75bf - code32flat_start ) ;
*16.*(.text.sercon_lazy_lf)
. = ( 0xf760f - code32flat_start ) ;
*16.*(.text.timer_calc)
. = ( 0xf762b - code32flat_start ) ;
*16.*(.text.timer_calc_usec)
. = ( 0xf765d - code32flat_start ) ;
*16.*(.text.timer_check)
. = ( 0xf7679 - code32flat_start ) ;
*16.*(.text.udelay)
. = ( 0xf769a - code32flat_start ) ;
*16.*(.text.ndelay.constprop.87)
. = ( 0xf76dc - code32flat_start ) ;
*16.*(.text.__dprintf)
. = ( 0xf76f0 - code32flat_start ) ;
*16.*(.text.dump_regs)
. = ( 0xf7787 - code32flat_start ) ;
*16.*(.text.__warn_timeout)
. = ( 0xf779d - code32flat_start ) ;
*16.*(.text.__i8042_command)
. = ( 0xf77f5 - code32flat_start ) ;
*16.*(.text.fill_generic_edd)
. = ( 0xf7b64 - code32flat_start ) ;
*16.*(.text.handle_12)
. = ( 0xf7b77 - code32flat_start ) ;
*16.*(.text.handle_11)
. = ( 0xf7b8a - code32flat_start ) ;
*16.*(.text.handle_02)
. = ( 0xf7b9f - code32flat_start ) ;
*16.*(.text.call16_helper)
. = ( 0xf7bdf - code32flat_start ) ;
*16.*(.text.__call32)
. = ( 0xf7ca3 - code32flat_start ) ;
*16.*(.text.__call32_params.constprop.98)
. = ( 0xf7ceb - code32flat_start ) ;
*16.*(.text.usb_poll_intr)
. = ( 0xf8044 - code32flat_start ) ;
*16.*(.text._farcall16)
. = ( 0xf808f - code32flat_start ) ;
*16.*(.text.__call16_int)
. = ( 0xf80a2 - code32flat_start ) ;
*16.*(.text.handle_75)
. = ( 0xf8101 - code32flat_start ) ;
*16.*(.text.disk_1346.isra.62)
. = ( 0xf819b - code32flat_start ) ;
*16.*(.text.process_key)
. = ( 0xf858d - code32flat_start ) ;
*16.*(.text.prockeys)
. = ( 0xf8604 - code32flat_start ) ;
*16.*(.text.ramdisk_copy)
. = ( 0xf877d - code32flat_start ) ;
*16.*(.text.check_irqs)
. = ( 0xf879f - code32flat_start ) ;
*16.*(.text.sercon_putchar)
. = ( 0xf880a - code32flat_start ) ;
*16.*(.text.sercon_term_clear_screen)
. = ( 0xf8837 - code32flat_start ) ;
*16.*(.text.sercon_term_cursor_goto)
. = ( 0xf88e2 - code32flat_start ) ;
*16.*(.text.sercon_set_attr)
. = ( 0xf89d7 - code32flat_start ) ;
*16.*(.text.sercon_lazy_flush)
. = ( 0xf8afe - code32flat_start ) ;
*16.*(.text.sercon_lazy_putchar)
. = ( 0xf8bb4 - code32flat_start ) ;
*16.*(.text.lsi_scsi_process_op)
. = ( 0xf8de3 - code32flat_start ) ;
*16.*(.text.esp_scsi_process_op)
. = ( 0xf8fb5 - code32flat_start ) ;
*16.*(.text.rtc_updating)
. = ( 0xf9002 - code32flat_start ) ;
*16.*(.text.ps2_recvbyte)
. = ( 0xf90b6 - code32flat_start ) ;
*16.*(.text.ps2_sendbyte)
. = ( 0xf9131 - code32flat_start ) ;
*16.*(.text.mouse_command)
. = ( 0xf9206 - code32flat_start ) ;
*16.*(.text.mouse_15c201)
. = ( 0xf9251 - code32flat_start ) ;
*16.*(.text.handle_160a)
. = ( 0xf92af - code32flat_start ) ;
*16.*(.text.uhci_waittick)
. = ( 0xf930b - code32flat_start ) ;
*16.*(.text.uhci_send_pipe.constprop.91)
. = ( 0xf96c8 - code32flat_start ) ;
*16.*(.text.ehci_send_pipe.constprop.92)
. = ( 0xf99c4 - code32flat_start ) ;
*16.*(.text.usb_send_pipe.constprop.90)
. = ( 0xf99fd - code32flat_start ) ;
*16.*(.text.usb_process_op)
. = ( 0xf9b8e - code32flat_start ) ;
*16.*(.text.uas_process_op)
. = ( 0xf9da7 - code32flat_start ) ;
*16.*(.text.floppy_pio)
. = ( 0xf9ef0 - code32flat_start ) ;
*16.*(.text.floppy_enable_controller)
. = ( 0xf9f53 - code32flat_start ) ;
*16.*(.text.floppy_drive_pio)
. = ( 0xfa005 - code32flat_start ) ;
*16.*(.text.floppy_dma_cmd)
. = ( 0xfa13b - code32flat_start ) ;
*16.*(.text.floppy_drive_readid.constprop.86)
. = ( 0xfa181 - code32flat_start ) ;
*16.*(.text.floppy_read)
. = ( 0xfa23a - code32flat_start ) ;
*16.*(.text.floppy_write)
. = ( 0xfa2f3 - code32flat_start ) ;
*16.*(.text.floppy_format)
. = ( 0xfa380 - code32flat_start ) ;
*16.*(.text.megasas_process_op)
. = ( 0xfa5e7 - code32flat_start ) ;
*16.*(.text.await_not_bsy)
. = ( 0xfa5f7 - code32flat_start ) ;
*16.*(.text.ata_pio_transfer)
. = ( 0xfa72a - code32flat_start ) ;
*16.*(.text.ata_wait_data)
. = ( 0xfa763 - code32flat_start ) ;
*16.*(.text.ata_readwrite)
. = ( 0xfa8e3 - code32flat_start ) ;
*16.*(.text.ata_atapi_process_op)
. = ( 0xfaa76 - code32flat_start ) ;
*16.*(.text.process_op)
. = ( 0xfae14 - code32flat_start ) ;
*16.*(.text.cdemu_read)
. = ( 0xfb03d - code32flat_start ) ;
*16.*(.text.disk_1300)
. = ( 0xfb079 - code32flat_start ) ;
*16.*(.text.basic_access)
. = ( 0xfb1a1 - code32flat_start ) ;
*16.*(.text.disk_1305)
. = ( 0xfb29e - code32flat_start ) ;
*16.*(.text.disk_1310)
. = ( 0xfb2dd - code32flat_start ) ;
*16.*(.text.extended_access)
. = ( 0xfb3ae - code32flat_start ) ;
*16.*(.text.disk_13)
. = ( 0xfb6d9 - code32flat_start ) ;
*16.*(.text.handle_legacy_disk)
. = ( 0xfb75d - code32flat_start ) ;
*16.*(.text.wait_irq)
. = ( 0xfb77d - code32flat_start ) ;
*16.*(.text.handle_1553)
. = ( 0xfb8e0 - code32flat_start ) ;
*16.*(.text.handle_40)
. = ( 0xfb912 - code32flat_start ) ;
*16.*(.text.handle_13)
. = ( 0xfb9b9 - code32flat_start ) ;
*16.*(.text.handle_76)
. = ( 0xfb9ca - code32flat_start ) ;
*16.*(.text.invoke_mouse_handler)
. = ( 0xfba3d - code32flat_start ) ;
*16.*(.text.process_mouse)
. = ( 0xfba94 - code32flat_start ) ;
*16.*(.text.handle_16)
. = ( 0xfbb8b - code32flat_start ) ;
*16.*(.text.handle_1589)
. = ( 0xfbc25 - code32flat_start ) ;
*16.*(.text.handle_15)
. = ( 0xfc37e - code32flat_start ) ;
*16.*(.text.handle_14)
. = ( 0xfc553 - code32flat_start ) ;
*16.*(.text.handle_sercon)
. = ( 0xfc95d - code32flat_start ) ;
*16.*(.text.handle_70)
. = ( 0xfca4f - code32flat_start ) ;
*16.*(.text.handle_resume)
. = ( 0xfcb1a - code32flat_start ) ;
*16.*(.text.handle_pnp)
. = ( 0xfcb63 - code32flat_start ) ;
*16.*(.text.handle_pcibios)
. = ( 0xfce86 - code32flat_start ) ;
*16.*(.text.handle_hwpic1)
. = ( 0xfce8c - code32flat_start ) ;
*16.*(.text.handle_74)
. = ( 0xfcec7 - code32flat_start ) ;
*16.*(.text.handle_09)
. = ( 0xfcf10 - code32flat_start ) ;
*16.*(.text.handle_0e)
. = ( 0xfcf2a - code32flat_start ) ;
*16.*(.text.asm.transition32)
. = ( 0xfcf78 - code32flat_start ) ;
*16.*(.text.asm.transition16)
. = ( 0xfcfc6 - code32flat_start ) ;
*16.*(.text.asm.__farcall16)
. = ( 0xfd053 - code32flat_start ) ;
*16.*(.text.asm.irq_trampoline_0x02)
. = ( 0xfd056 - code32flat_start ) ;
*16.*(.text.asm.irq_trampoline_0x05)
. = ( 0xfd059 - code32flat_start ) ;
*16.*(.text.asm.irq_trampoline_0x10)
. = ( 0xfd05c - code32flat_start ) ;
*16.*(.text.asm.irq_trampoline_0x13)
. = ( 0xfd05f - code32flat_start ) ;
*16.*(.text.asm.irq_trampoline_0x15)
. = ( 0xfd062 - code32flat_start ) ;
*16.*(.text.asm.irq_trampoline_0x16)
. = ( 0xfd065 - code32flat_start ) ;
*16.*(.text.asm.irq_trampoline_0x18)
. = ( 0xfd068 - code32flat_start ) ;
*16.*(.text.asm.irq_trampoline_0x19)
. = ( 0xfd06b - code32flat_start ) ;
*16.*(.text.asm.irq_trampoline_0x1b)
. = ( 0xfd06e - code32flat_start ) ;
*16.*(.text.asm.irq_trampoline_0x1c)
. = ( 0xfd071 - code32flat_start ) ;
*16.*(.text.asm.entry_smi)
. = ( 0xfd086 - code32flat_start ) ;
*16.*(.text.asm.entry_smp)
. = ( 0xfd0b6 - code32flat_start ) ;
*16.*(.text.asm.entry_resume)
. = ( 0xfd0cb - code32flat_start ) ;
*16.*(.text.asm.entry_pmm)
. = ( 0xfd129 - code32flat_start ) ;
*16.*(.text.asm.entry_pnp_real)
. = ( 0xfd171 - code32flat_start ) ;
*16.*(.text.asm.entry_apm16)
. = ( 0xfd1b2 - code32flat_start ) ;
*16.*(.text.asm.entry_apm32)
. = ( 0xfd1e4 - code32flat_start ) ;
*16.*(.text.asm.entry_pcibios32)
. = ( 0xfd212 - code32flat_start ) ;
*16.*(.text.asm.entry_pcibios16)
. = ( 0xfd24c - code32flat_start ) ;
*16.*(.text.asm.entry_1589)
. = ( 0xfd286 - code32flat_start ) ;
*16.*(.text.asm.entry_bios32)
. = ( 0xfd2a5 - code32flat_start ) ;
*16.*(.text.asm.entry_sercon)
. = ( 0xfd2ec - code32flat_start ) ;
*16.*(.text.asm.irqentry_extrastack)
. = ( 0xfd379 - code32flat_start ) ;
*16.*(.text.asm.irqentry_arg_extrastack)
. = ( 0xfd41b - code32flat_start ) ;
*16.*(.text.asm.entry_13)
. = ( 0xfd424 - code32flat_start ) ;
*16.*(.text.asm.entry_76)
. = ( 0xfd42d - code32flat_start ) ;
*16.*(.text.asm.entry_70)
. = ( 0xfd436 - code32flat_start ) ;
*16.*(.text.asm.entry_74)
. = ( 0xfd43f - code32flat_start ) ;
*16.*(.text.asm.entry_75)
. = ( 0xfd448 - code32flat_start ) ;
*16.*(.text.asm.entry_hwpic1)
. = ( 0xfd451 - code32flat_start ) ;
*16.*(.text.asm.entry_hwpic2)
. = ( 0xfd45a - code32flat_start ) ;
*16.*(.text.asm.entry_19)
. = ( 0xfd46d - code32flat_start ) ;
*16.*(.text.asm.entry_18)
. = ( 0xfd480 - code32flat_start ) ;
_rodata16 = . ;
*16.*(.rodata)
. = ( 0xfd8c4 - code32flat_start ) ;
*16.*(.rodata.__func__.12577)
. = ( 0xfd8d8 - code32flat_start ) ;
*16.*(.rodata.__func__.11793)
. = ( 0xfd8e4 - code32flat_start ) ;
*16.*(.rodata.__func__.11751)
. = ( 0xfd8f0 - code32flat_start ) ;
*16.*(.rodata.__func__.11425)
. = ( 0xfd8fc - code32flat_start ) ;
*16.*(.rodata.__func__.11405)
. = ( 0xfd90c - code32flat_start ) ;
*16.*(.rodata.__func__.10358)
. = ( 0xfd91c - code32flat_start ) ;
*16.*(.rodata.__func__.10436)
. = ( 0xfd92c - code32flat_start ) ;
*16.*(.rodata.__func__.8845)
. = ( 0xfd938 - code32flat_start ) ;
*16.*(.rodata.__func__.8938)
. = ( 0xfd940 - code32flat_start ) ;
*16.*(.rodata.__func__.8718)
. = ( 0xfd950 - code32flat_start ) ;
*16.*(.rodata.__func__.7831)
. = ( 0xfd960 - code32flat_start ) ;
*16.*(.rodata.__func__.7779)
. = ( 0xfd974 - code32flat_start ) ;
*16.*(.rodata.__func__.4547)
. = ( 0xfd980 - code32flat_start ) ;
*16.*(.rodata.__func__.4902)
. = ( 0xfd98c - code32flat_start ) ;
*16.*(.rodata.__func__.1841)
. = ( 0xfd998 - code32flat_start ) ;
*16.*(.rodata.__func__.1828)
. = ( 0xfd9a4 - code32flat_start ) ;
*16.*(.rodata.__func__.1824)
. = ( 0xfd9b0 - code32flat_start ) ;
*16.*(.data16../src/hw/usb-hid.c.184)
. = ( 0xfd9c0 - code32flat_start ) ;
*16.*(.data16../src/hw/usb-hid.c.167)
. = ( 0xfdaa0 - code32flat_start ) ;
*16.*(.data16../src/cp437.c.11)
. = ( 0xfdca0 - code32flat_start ) ;
*16.*(.data16../src/sercon.c.554)
. = ( 0xfdd50 - code32flat_start ) ;
*16.*(.data16../src/sercon.c.70)
. = ( 0xfdd58 - code32flat_start ) ;
*16.*(.data16../src/kbd.c.374)
. = ( 0xfdd60 - code32flat_start ) ;
*16.*(.data16../src/kbd.c.371)
. = ( 0xfdd80 - code32flat_start ) ;
*16.*(.data16../src/kbd.c.279)
. = ( 0xfe048 - code32flat_start ) ;
*16.*(.data16../src/mouse.c.106)
. = ( 0xfe05b - code32flat_start ) ;
*16.*(.fixedaddr.0xe05b)
. = ( 0xfe079 - code32flat_start ) ;
*16.*(.text.fill_edd)
. = ( 0xfe2ad - code32flat_start ) ;
*16.*(.text.unlikely.panic.constprop.96)
. = ( 0xfe2c3 - code32flat_start ) ;
*16.*(.fixedaddr.0xe2c3)
. = ( 0xfe2e8 - code32flat_start ) ;
*16.*(.text.send_cmd)
. = ( 0xfe3fe - code32flat_start ) ;
*16.*(.fixedaddr.0xe3fe)
. = ( 0xfe401 - code32flat_start ) ;
*32flat.*(.fixedaddr.0xe401)
. = ( 0xfe411 - code32flat_start ) ;
*16.*(.text.bvprintf.constprop.100)
. = ( 0xfe6a8 - code32flat_start ) ;
*16.*(.text.putuint.isra.53)
. = ( 0xfe6f2 - code32flat_start ) ;
*16.*(.fixedaddr.0xe6f2)
. = ( 0xfe6f5 - code32flat_start ) ;
*32flat.*(.fixedaddr.0xe6f5)
. = ( 0xfe6ff - code32flat_start ) ;
*16.*(.text.sercon_cursor_pos_set)
. = ( 0xfe729 - code32flat_start ) ;
*32flat.*(.fixedaddr.0xe729)
. = ( 0xfe739 - code32flat_start ) ;
*16.*(.fixedaddr.0xe739)
. = ( 0xfe742 - code32flat_start ) ;
*16.*(.text.dequeue_key)
. = ( 0xfe826 - code32flat_start ) ;
*16.*(.text.pic_eoi2)
. = ( 0xfe82e - code32flat_start ) ;
*16.*(.fixedaddr.0xe82e)
. = ( 0xfe837 - code32flat_start ) ;
*16.*(.text.handle_17)
. = ( 0xfe987 - code32flat_start ) ;
*16.*(.fixedaddr.0xe987)
. = ( 0xfe990 - code32flat_start ) ;
*16.*(.text.floppy_prep)
. = ( 0xfec4e - code32flat_start ) ;
*16.*(.text.usleep)
. = ( 0xfec59 - code32flat_start ) ;
*16.*(.fixedaddr.0xec59)
. = ( 0xfec62 - code32flat_start ) ;
*16.*(.text.__ps2_command)
. = ( 0xfeeda - code32flat_start ) ;
*16.*(.text.floppy_wait_irq)
. = ( 0xfef57 - code32flat_start ) ;
*16.*(.fixedaddr.0xef57)
. = ( 0xfef60 - code32flat_start ) ;
*16.*(.text.sercon_print_utf8)
. = ( 0xfefc7 - code32flat_start ) ;
*32flat.*(.fixedaddr.0xefc7)
. = ( 0xfefd2 - code32flat_start ) ;
*16.*(.fixedaddr.0xefd2)
. = ( 0xfefdb - code32flat_start ) ;
*16.*(.text.set_leds)
. = ( 0xff041 - code32flat_start ) ;
*16.*(.text.asm.irq_trampoline_0x4a)
. = ( 0xff045 - code32flat_start ) ;
*16.*(.fixedaddr.0xf045)
. = ( 0xff046 - code32flat_start ) ;
*16.*(.text.timer_sleep)
. = ( 0xff065 - code32flat_start ) ;
*16.*(.fixedaddr.0xf065)
. = ( 0xff066 - code32flat_start ) ;
*16.*(.text.i8042_wait_write)
. = ( 0xff0a4 - code32flat_start ) ;
*32flat.*(.fixedaddr.0xf0a4)
. = ( 0xff0fc - code32flat_start ) ;
*16.*(.text.handle_08)
. = ( 0xff562 - code32flat_start ) ;
*16.*(.text.handle_1a)
. = ( 0xff7d2 - code32flat_start ) ;
*16.*(.text.await_ide.constprop.89)
. = ( 0xff841 - code32flat_start ) ;
*16.*(.fixedaddr.0xf841)
. = ( 0xff84a - code32flat_start ) ;
*16.*(.text.handle_hwpic2)
. = ( 0xff84d - code32flat_start ) ;
*16.*(.fixedaddr.0xf84d)
. = ( 0xff856 - code32flat_start ) ;
*16.*(.text.handle_apm)
. = ( 0xff859 - code32flat_start ) ;
*16.*(.fixedaddr.0xf859)
. = ( 0xff869 - code32flat_start ) ;
*16.*(.text.mpt_scsi_process_op)
. = ( 0xffa47 - code32flat_start ) ;
*16.*(.text.handle_05)
. = ( 0xffa6e - code32flat_start ) ;
*32flat.*(.fixedaddr.0xfa6e)
. = ( 0xffe6e - code32flat_start ) ;
*16.*(.fixedaddr.0xfe6e)
. = ( 0xffe7e - code32flat_start ) ;
*16.*(.text.rtc_setup)
. = ( 0xffea5 - code32flat_start ) ;
*16.*(.fixedaddr.0xfea5)
. = ( 0xffeae - code32flat_start ) ;
*16.*(.text.shiftbuf)
. = ( 0xffef3 - code32flat_start ) ;
*32flat.*(.fixedaddr.0xfef3)
. = ( 0xfff00 - code32flat_start ) ;
*16.*(.text.procmodkey)
. = ( 0xfff53 - code32flat_start ) ;
*16.*(.fixedaddr.0xff53)
. = ( 0xfff54 - code32flat_start ) ;
*16.*(.fixedaddr.0xff54)
. = ( 0xfff5d - code32flat_start ) ;
*16.*(.text.timer_read)
. = ( 0xffff0 - code32flat_start ) ;
*16.*(.fixedaddr.0xfff0)
. = ( 0xffff5 - code32flat_start ) ;
*32flat.*(.fixedaddr.0xfff5)
. = ( 0xffffe - code32flat_start ) ;
*32flat.*(.fixedaddr.0xfffe)
. = ( 0xfffff - code32flat_start ) ;
*32flat.*(.fixedaddr.0xffff)

        code32flat_end = ABSOLUTE(.) ;
    } :text


        /* Discard regular data sections to force a link error if
         * code attempts to access data not marked with VAR16 (or other
         * appropriate macro)
         */
        /DISCARD/ : {
                *(.text*) *(.data*) *(.bss*) *(.rodata*)
                *(COMMON) *(.discard*) *(.eh_frame) *(.note*)
                }
}

ENTRY(reset_vector)
PHDRS
{
        text PT_LOAD AT ( code32flat_start ) ;
}
